## drivers/input/touchscreen/ft_zte/Kconfig
```kconfig
#
# Goodix GT9xx Touchscreen driver
#

config TOUCHSCREEN_FTS_ZTE
	tristate "ft touchpanel driver"
	depends on TOUCHSCREEN_FT_ZTE
	default n
	help
	  This is the main file for touchpanel driver for Goodix GT9xx
	  touchscreens.

	  Say Y here if you have a Goodix GT9xx touchscreen connected
	  to your system.

	  If unsure, say N.
```
