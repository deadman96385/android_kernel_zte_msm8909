/* Copyright (c) 2015, The Linux Foundation. All rights reserved.
 *
 * This program is free software; you can redistribute it and/or modify
 * it under the terms of the GNU General Public License version 2 and
 * only version 2 as published by the Free Software Foundation.
 *
 * This program is distributed in the hope that it will be useful,
 * but WITHOUT ANY WARRANTY; without even the implied warranty of
 * MERCHANTABILITY or FITNESS FOR A PARTICULAR PURPOSE.  See the
 * GNU General Public License for more details.
 */

&mdss_mdp {
	dsi_st7701_fwvga_video: qcom,mdss_dsi_lead_st7701_cpt_5p_fwvga_video {
		qcom,mdss-dsi-panel-name = "zteLEAD_st7701_cpt_480_854_5.0Inch";
		qcom,mdss-dsi-panel-controller = <&mdss_dsi0>;
		qcom,mdss-dsi-panel-type = "dsi_video_mode";
		qcom,mdss-dsi-panel-destination = "display_1";
		qcom,mdss-dsi-panel-framerate = <60>;
		qcom,mdss-dsi-virtual-channel-id = <0>;
		qcom,mdss-dsi-stream = <0>;
		qcom,mdss-pan-physical-height-dimension = <110>;
		qcom,mdss-pan-physical-width-dimension = <62>;
		qcom,mdss-dsi-panel-width = <480>;
		qcom,mdss-dsi-panel-height = <854>;
		qcom,mdss-dsi-h-front-porch = <80>;
		qcom,mdss-dsi-h-back-porch = <80>;
		qcom,mdss-dsi-h-pulse-width = <4>;
		qcom,mdss-dsi-h-sync-skew = <0>;
		qcom,mdss-dsi-v-back-porch = <16>;
		qcom,mdss-dsi-v-front-porch = <18>;
		qcom,mdss-dsi-v-pulse-width = <4>;
		qcom,mdss-dsi-h-left-border = <0>;
		qcom,mdss-dsi-h-right-border = <0>;
		qcom,mdss-dsi-v-top-border = <0>;
		qcom,mdss-dsi-v-bottom-border = <0>;
		qcom,mdss-dsi-bpp = <24>;
		qcom,mdss-dsi-color-order = "rgb_swap_rgb";
		qcom,mdss-dsi-underflow-color = <0xff>;
		qcom,mdss-dsi-border-color = <0>;
		qcom,mdss-dsi-on-command = [

			29 01 00 00 00 00 06 FF 77 01 00 00 11
			29 01 00 00 00 00 02 D1 11

			05 01 00 00 78 00 02 11 00

			29 01 00 00 00 00 06 FF 77 01 00 00 10

			29 01 00 00 00 00 03 C0 E9 03

			29 01 00 00 00 00 03 C1 0A 02

			29 01 00 00 00 00 03 C2 37 08 /* change to colomn flip, 170317 */

			29 01 00 00 00 00 11 B0 00 0f 59 14 19 0b 0e 09 09 22 06 13 0f 15 1a 15

			29 01 00 00 00 00 11 B1 00 0f 59 10 14 08 0d 09 0a 23 0a 19 16 16 1a 15

			29 01 00 00 00 00 06 FF 77 01 00 00 11

			29 01 00 00 00 00 02 b0 4D

			29 01 00 00 00 00 02 b1 31
			29 01 00 00 00 00 02 b2 07
			29 01 00 00 00 00 02 b3 80
			29 01 00 00 00 00 02 b5 47
			29 01 00 00 00 00 02 b7 85
			29 01 00 00 00 00 02 b8 10
			29 01 00 00 00 00 02 C1 78
			29 01 00 00 00 00 02 C2 78
			29 01 00 00 00 00 02 D0 88

			29 01 00 00 00 00 04 E0 00 00 02

			29 01 00 00 00 00 0c E1 02 00 00 00 01 00 00 00 00 40 40
			29 01 00 00 00 00 0e E2 30 30 40 40 60 00 00 00 5F 00 00 00 00

			29 01 00 00 00 00 05 E3 00 00 33 33
			29 01 00 00 00 00 03 E4 44 44

			29 01 00 00 00 00 11 E5 07 6B A0 A0 09 6B A0 A0 0B 6B A0 A0 0D 6B A0 A0

			29 01 00 00 00 00 05 e6 00 00 33 33

			29 01 00 00 00 00 03 E7 44 44

			29 01 00 00 00 00 11 E8 06 6B A0 A0 08 6B A0 A0 0A 6B A0 A0 0C 6B A0 A0

			29 01 00 00 00 00 08 EB 02 00 93 93 88 00 00

			29 01 00 00 00 00 03 EC 00 00

			29 01 00 00 00 00 11 ED FA B0 2F F4 65 7F FF FF FF FF F7 56 4F F2 0B AF

			29 01 00 00 00 00 06 FF 77 01 00 00 10

			29 01 00 00 00 00 02 BC 00 /*pwm=5kHz*/


			29 01 00 00 00 00 06 FF 77 01 00 00 00

			29 01 00 00 00 00 02 35 00
			29 01 00 00 00 00 02 51 00
			29 01 00 00 00 00 02 53 2C
			29 01 00 00 00 00 02 55 00 /* disable cabc, 170317 */

			05 01 00 00 0a 00 02 29 00
		];
		qcom,mdss-dsi-off-command = [
			29 01 00 00 00 00 02 53 00
			05 01 00 00 00 00 02 28 00
			05 01 00 00 28 00 02 10 00
			];
		qcom,mdss-dsi-on-command-state = "dsi_lp_mode";
		qcom,mdss-dsi-off-command-state = "dsi_hs_mode";
		qcom,mdss-dsi-h-sync-pulse = <1>;
		qcom,mdss-dsi-traffic-mode = "burst_mode";
		qcom,mdss-dsi-lane-map = "lane_map_0123";
		qcom,mdss-dsi-bllp-eof-power-mode;
		qcom,mdss-dsi-bllp-power-mode;
		qcom,suspend-ulps-enabled;
		qcom,mdss-dsi-lane-0-state;
		qcom,mdss-dsi-lane-1-state;
		qcom,mdss-dsi-panel-timings = [7b 1a 10 00 3e 40 16 1c 15 03 04 00];
		qcom,mdss-dsi-t-clk-post = <0x04>;
		qcom,mdss-dsi-t-clk-pre = <0x1a>;
		qcom,mdss-dsi-bl-min-level = <1>;
		qcom,mdss-dsi-bl-max-level = <255>;
		qcom,mdss-dsi-dma-trigger = "trigger_sw";
		qcom,mdss-dsi-mdp-trigger = "none";
		qcom,mdss-dsi-bl-pmic-control-type = "bl_ctrl_dcs";
		qcom,mdss-dsi-reset-sequence = <1 20>, <0 5>, <1 20>;
		qcom,mdss-dsi-lp11-init;
		qcom,mdss-dsi-init-delay-us = <7000>;
	};
};
