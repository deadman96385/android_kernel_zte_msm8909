/* Copyright (c) 2015, The Linux Foundation. All rights reserved.
 *
 * This program is free software; you can redistribute it and/or modify
 * it under the terms of the GNU General Public License version 2 and
 * only version 2 as published by the Free Software Foundation.
 *
 * This program is distributed in the hope that it will be useful,
 * but WITHOUT ANY WARRANTY; without even the implied warranty of
 * MERCHANTABILITY or FITNESS FOR A PARTICULAR PURPOSE.  See the
 * GNU General Public License for more details.
 */

&mdss_mdp {
	dsi_helitai_fl10802_5p0_fwvga_video: qcom,mdss_dsi_helitai_fl10802_5p0_fwvga_video {
		qcom,mdss-dsi-panel-name = "zteHELITAI(FL10802)CPT_480*854_5.0Inch";
		qcom,mdss-dsi-panel-controller = <&mdss_dsi0>;
		qcom,mdss-dsi-panel-type = "dsi_video_mode";
		qcom,mdss-dsi-panel-destination = "display_1";
		qcom,cont-splash-enabled;
		qcom,mdss-dsi-panel-framerate = <60>;
		qcom,mdss-dsi-virtual-channel-id = <0>;
		qcom,mdss-dsi-stream = <0>;
		qcom,mdss-pan-physical-height-dimension = <110>;
		qcom,mdss-pan-physical-width-dimension = <62>;
		qcom,mdss-dsi-panel-width = <480>;
		qcom,mdss-dsi-panel-height = <854>;
		qcom,mdss-dsi-h-front-porch = <94>;
		qcom,mdss-dsi-h-back-porch = <84>;
		qcom,mdss-dsi-h-pulse-width = <59>;
		qcom,mdss-dsi-h-sync-skew = <0>;
		qcom,mdss-dsi-v-back-porch = <12>;
		qcom,mdss-dsi-v-front-porch = <18>;
		qcom,mdss-dsi-v-pulse-width = <4>;
		qcom,mdss-dsi-h-left-border = <0>;
		qcom,mdss-dsi-h-right-border = <0>;
		qcom,mdss-dsi-v-top-border = <0>;
		qcom,mdss-dsi-v-bottom-border = <0>;
		qcom,mdss-dsi-bpp = <24>;
		qcom,mdss-dsi-color-order = "rgb_swap_rgb";
		qcom,mdss-dsi-underflow-color = <0xff>;
		qcom,mdss-dsi-border-color = <0>;
		qcom,mdss-dsi-panel-status-command = [14 01 00 01 05 00 01 09];
		qcom,mdss-dsi-panel-status-command-mode = "dsi_lp_mode";
		qcom,mdss-dsi-panel-status-check-mode = "reg_read";
		qcom,mdss-dsi-panel-status-read-length = <1>;
		qcom,mdss-dsi-panel-status-value = <0x80>;
		qcom,esd-check-enabled; //enables ESD
		qcom,mdss-dsi-on-command = [
			29 00 00 00 00 00 04 B9 F1 08 01
			29 00 00 00 00 00 08 B1 2a 1A 1A 87 30 01 AB //22->2a, according to fae luohaihua.
			29 00 00 00 00 00 02 B2 22
			29 00 00 00 00 00 09 B3 01 00 06 06 18 13 39 35
			29 00 00 00 00 00 12 BA 31 00 44 25 91 0A 00 00 C1 00 00 00 0D 02 4F B9 EE
			29 00 00 00 00 00 06 E3 09 09 03 03 00
			29 00 00 00 00 00 02 B4 00
			29 00 00 00 00 00 03 B5 07 07
			29 00 00 00 00 00 03 B6 4d 4d //flicker problem
			29 00 00 00 00 00 03 B8 64 22
			29 00 00 00 00 00 02 C7 A0 //backlight direction
			29 00 00 00 00 00 03 C8 10 00  //pwm frequency=30kHz
			29 00 00 00 00 00 02 CC 00
			29 00 00 00 00 00 02 BC 47  //zte_tzb modify 44 to 47 to solve panel flash problem, 20160328
			29 00 00 00 00 00 34 E9 00 00 09 03 65 0A 8A 10 01 00 37
			0D 0A 8A 37 00 00 18 00 00 00 25 09 80 40 00 42 60 00 00 00 09 81 50
			01 53 70 00 00 00 00 00 00 00 00 00 00 00 00 00 00
			29 00 00 00 00 00 13 EA 94 00 00 00 08 95 10 07 35 10 00 00 00 08 94 00 06 24
			29 00 00 00 00 00 23 E0 00 00 07 14 1D 2A 24 3A 0A 11 10 12
			15 12 15 0F 13 00 00 07 14 1D 2A 24 3A 0A 11 10 12 15 12 15 0F 13
			//add to open backlight, otherwise the panel can not display when sleep out.
			29 00 00 00 00 00 02 53 24
			05 01 00 00 78 00 02 11 00
			05 01 00 00 10 00 02 29 00];
		qcom,mdss-dsi-off-command = [
			05 01 00 00 00 00 02 28 00
			05 01 00 00 28 00 02 10 00];
		qcom,mdss-dsi-on-command-state = "dsi_lp_mode";
		qcom,mdss-dsi-off-command-state = "dsi_hs_mode";
		qcom,mdss-dsi-h-sync-pulse = <1>;
		qcom,mdss-dsi-traffic-mode = "burst_mode";
		qcom,mdss-dsi-lane-map = "lane_map_0123";
		qcom,mdss-dsi-bllp-eof-power-mode;
		qcom,mdss-dsi-bllp-power-mode;
		qcom,suspend-ulps-enabled;
		qcom,mdss-dsi-lane-0-state;
		qcom,mdss-dsi-lane-1-state;
		//qcom,mdss-dsi-panel-timings =[7B 1A 10 00 3E 40 16 1E 15 03 04 00];
		//qcom,mdss-dsi-panel-timings =[7A 1A 12 00 3E 42 16 1E 14 03 04 00];
		//qcom,mdss-dsi-t-clk-post = <0x04>;
		//qcom,mdss-dsi-t-clk-pre = <0x1A>;
		qcom,mdss-dsi-panel-timings =[87 1c 12 00 42 44 18 20 17 03 04 00];
		qcom,mdss-dsi-t-clk-post = <0x04>;
		qcom,mdss-dsi-t-clk-pre = <0x1B>;
		qcom,mdss-dsi-bl-min-level = <1>;
		qcom,mdss-dsi-bl-max-level = <255>;
		qcom,mdss-dsi-dma-trigger = "trigger_sw";
		qcom,mdss-dsi-mdp-trigger = "none";
		qcom,mdss-dsi-bl-pmic-control-type = "bl_ctrl_dcs";
		qcom,mdss-dsi-reset-sequence = <1 5>, <0 5>, <1 20>;
		qcom,mdss-dsi-lp11-init;
		qcom,mdss-dsi-init-delay-us = <7000>;
	};
};
