/* Copyright (c) 2012, Code Aurora Forum. All rights reserved.
 *
 * This program is free software; you can redistribute it and/or modify
 * it under the terms of the GNU General Public License version 2 and
 * only version 2 as published by the Free Software Foundation.
 *
 * This program is distributed in the hope that it will be useful,
 * but WITHOUT ANY WARRANTY; without even the implied warranty of
 * MERCHANTABILITY or FITNESS FOR A PARTICULAR PURPOSE.  See the
 * GNU General Public License for more details.
 */

/*---------------------------------------------------------------------------
* This file is autogenerated file using gcdb parser. Please do not edit it.
* Update input XML file to add a new entry or update variable in this file
* VERSION = "1.0"
*file name:dsi-panel-zte-lead-nt35521-cpt-5p5-720p-video.h
*author   :created by tangzhengbo at 20150109
*---------------------------------------------------------------------------*/
&mdss_mdp {

		dsi_helitai_s6d7aa6x01_cpt_5p5_720p_video: qcom,mdss_dsi_helitai_s6d7aa6x01_cpt_5p5_720p_video{
		qcom,mdss-dsi-panel-name =  "zteHELITAI(S6D7AA6X01)CPT_720*1280_5.5Inch";
		qcom,cont-splash-enabled;
		qcom,mdss-dsi-panel-controller = <&mdss_dsi0>;
		qcom,mdss-dsi-panel-type = "dsi_video_mode";
		qcom,mdss-dsi-panel-destination = "display_1";
		qcom,mdss-dsi-panel-framerate = <60>;
		qcom,mdss-dsi-virtual-channel-id = <0>;
		qcom,mdss-dsi-stream = <0>;
		qcom,mdss-pan-physical-height-dimension = <121>;
		qcom,mdss-pan-physical-width-dimension = <68>;
		qcom,mdss-dsi-panel-width = <720>;
		qcom,mdss-dsi-panel-height = <1280>;
		qcom,mdss-dsi-h-front-porch = <200>;
		qcom,mdss-dsi-h-back-porch = <100>;
		qcom,mdss-dsi-h-pulse-width = <8>;
		qcom,mdss-dsi-h-sync-skew = <0>;
		qcom,mdss-dsi-v-back-porch = <12>;
		qcom,mdss-dsi-v-front-porch = <16>;
		qcom,mdss-dsi-v-pulse-width = <4>;
		qcom,mdss-dsi-h-left-border = <0>;
		qcom,mdss-dsi-h-right-border = <0>;
		qcom,mdss-dsi-v-top-border = <0>;
		qcom,mdss-dsi-v-bottom-border = <0>;
		qcom,mdss-dsi-bpp = <24>;
		qcom,mdss-dsi-color-order = <0>;
		qcom,mdss-dsi-underflow-color = <0xff>;
		qcom,mdss-dsi-border-color = <0>;
		zte,lcd-12bit-backlight-enable;
		qcom,mdss-dsi-on-command = [
				39 01 00 00 00 00 03 F0 5A 5A
				39 01 00 00 00 00 03 F1 5A 5A
				39 01 00 00 00 00 03 FC 5A 5A
				39 01 00 00 00 00 07 B1 25 40 E8 10 00 22
				39 01 00 00 00 00 05 F2 10 10 0E 0D
				39 01 00 00 00 00 02 B0 02
				39 01 00 00 00 00 11 F5 10 6B 30 23 4C 4C 03 03 04 22 11 31 50 2A 16 75
				39 01 00 00 00 00 08 F6 04 8C 0F 80 46 00 00
				39 01 00 00 00 00 17 F7 0C 25 24 01 01 1A 18 16 14 01 01 01 01 01 01 04 01 01
				01 01 01 01
				39 01 00 00 00 00 17 F8 0D 25 24 01 01 1B 19 17 15 01 01 01 01 01 01 05 01 01
				01 01 01 01
				39 01 00 00 00 00 0C ED C0 58 38 58 38 58 38 04 04 11 22
				39 01 00 00 00 00 19 EE 67 89 45 23 55 55 55 55 43 32 87 A9 33 33 33 33 89 01
				00 00 01 89 00 00
				39 01 00 00 00 00 21 EF 3D 09 00 40 06 67 45 23 01 00 00 00 00 04 80 80 84 07
				09 89 08 12 21 21 03 03 44 33 00 00 00 00
				39 01 00 00 00 00 12 FA 10 30 18 1F 16 1B 20 1F 20 28 2B 2A 2B 29 28 28 2D
				39 01 00 00 00 00 12 FB 10 30 18 1F 16 1B 20 1F 20 28 2B 2A 2B 29 28 28 2D
				39 01 00 00 00 00 02 C5 21
				39 01 00 00 00 00 02 FE 48
				39 01 00 00 00 00 03 C8 24 53
				39 01 00 00 00 00 02 C0 03
				39 01 00 00 00 00 04 C1 70 1e 22
				39 01 00 00 00 00 03 51 00 00
				39 01 00 00 00 00 02 53 2c
				39 01 00 00 00 00 02 55 01
				05 01 00 00 78 00 02 11 00
				05 01 00 00 14 00 02 29 00];
		qcom,mdss-dsi-off-command = [05 01 00 00 32 00 02 28 00
				39 01 00 00 00 00 03 F0 5A 5A
				39 01 00 00 00 00 03 FA FF FF
				39 01 00 00 00 00 03 FB FF FF
				05 01 00 00 96 00 02 10 00];
		qcom,mdss-dsi-on-command-state = "dsi_lp_mode";
		qcom,mdss-dsi-off-command-state = "dsi_hs_mode";
		qcom,esd-check-enabled;
		qcom,mdss-dsi-panel-status-command = [24 01 00 01 05 00 02 0A 08];
		qcom,mdss-dsi-panel-status-command-state = "dsi_lp_mode";
		qcom,mdss-dsi-panel-status-check-mode = "reg_read";
		qcom,mdss-dsi-panel-status-value = <0x9c>;
		qcom,mdss-dsi-h-sync-pulse = <1>;
		qcom,mdss-dsi-traffic-mode = "burst_mode";
		qcom,mdss-dsi-lane-map = "lane_map_0123";
		qcom,mdss-dsi-bllp-eof-power-mode;
		qcom,mdss-dsi-bllp-power-mode;
		qcom,mdss-dsi-hfp-power-mode;
		qcom,mdss-dsi-lane-0-state;
		qcom,mdss-dsi-lane-1-state;
		qcom,mdss-dsi-lane-2-state;
		qcom,mdss-dsi-lane-3-state;
		qcom,mdss-dsi-panel-timings = [8B 1E 14 00 44 48 18 22 19 03 04 00];
		qcom,mdss-dsi-t-clk-post = <0x04>;
		qcom,mdss-dsi-t-clk-pre = <0x1C>;
		qcom,mdss-dsi-bl-min-level = <1>;
		qcom,mdss-dsi-bl-max-level = <255>;
		qcom,mdss-dsi-bl-pmic-control-type = "bl_ctrl_dcs";
		qcom,mdss-dsi-dma-trigger = "trigger_sw";
		qcom,mdss-dsi-mdp-trigger = "none";
		qcom,mdss-dsi-reset-sequence = <1 20>, <0 20>, <1 20>;
		qcom,mdss-dsi-post-init-delay = <4>;
	};
};
