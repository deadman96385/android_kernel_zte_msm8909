/* Copyright (c) 2015, The Linux Foundation. All rights reserved.
 *
 * This program is free software; you can redistribute it and/or modify
 * it under the terms of the GNU General Public License version 2 and
 * only version 2 as published by the Free Software Foundation.
 *
 * This program is distributed in the hope that it will be useful,
 * but WITHOUT ANY WARRANTY; without even the implied warranty of
 * MERCHANTABILITY or FITNESS FOR A PARTICULAR PURPOSE.  See the
 * GNU General Public License for more details.
 */

&mdss_mdp {
	dsi_hx8379c_fwvga_video: qcom,mdss_dsi_yassy_hx8379c_cpt_5p0_fwvga_video {
		qcom,mdss-dsi-panel-name = "zteYASHI(HX8379C)cpt_480*854_5.0Inch";
		qcom,mdss-dsi-panel-controller = <&mdss_dsi0>;
		qcom,mdss-dsi-panel-type = "dsi_video_mode";
		qcom,mdss-dsi-panel-destination = "display_1";
		qcom,mdss-dsi-panel-framerate = <60>;
		qcom,mdss-dsi-virtual-channel-id = <0>;
		qcom,mdss-dsi-stream = <0>;
		qcom,mdss-pan-physical-height-dimension = <110>;
		qcom,mdss-pan-physical-width-dimension = <62>;
		qcom,mdss-dsi-panel-width = <480>;
		qcom,mdss-dsi-panel-height = <854>;
		qcom,mdss-dsi-h-front-porch = <36>;
		qcom,mdss-dsi-h-back-porch = <36>;
		qcom,mdss-dsi-h-pulse-width = <36>;
		qcom,mdss-dsi-h-sync-skew = <0>;
		qcom,mdss-dsi-v-back-porch = <6>;
		qcom,mdss-dsi-v-front-porch = <6>;
		qcom,mdss-dsi-v-pulse-width = <5>;
		qcom,mdss-dsi-h-left-border = <0>;
		qcom,mdss-dsi-h-right-border = <0>;
		qcom,mdss-dsi-v-top-border = <0>;
		qcom,mdss-dsi-v-bottom-border = <0>;
		qcom,mdss-dsi-bpp = <24>;
		qcom,mdss-dsi-color-order = "rgb_swap_rgb";
		qcom,mdss-dsi-underflow-color = <0xff>;
		qcom,mdss-dsi-border-color = <0>;
		qcom,mdss-dsi-on-command=[
		39 01 00 00 00 00 04 B9 FF 83 79
		39 01 00 00 00 00 11 B1 C4 12 12 31 31 50 D0 EE 54 80 38 38 F8 33 32 22
		39 01 00 00 00 00 0A B2 80 FE 0B 04 00 50 11 42 1D
		39 01 00 00 00 00 0B B4 6A 78 02 74 02 74 22 86 23 86
		39 01 00 00 00 00 1E D3 00 00 00 00 00 0A 0A 32 10 03 00 03 03 60 03 60 00 08 00 08 65 44 08 08 37 08 08 37 09
		39 01 00 00 00 00 23 D5 18 18 19 19 18 18 20 21 24 25 18 18 18 18 00 01 04 05 02 03 06 07 18 18 18 18 18 18 18 18 18 18 00 00
		39 01 00 00 00 00 21 D6 18 18 18 18 19 19 25 24 21 20 18 18 18 18 05 04 01 00 03 02 07 06 18 18 18 18 18 18 18 18 18 18
		//39 01 00 00 00 00 2B E0 00 00 00 08 0B 3F 17 2A 07 0C 0E 18 10 14 17 15 16 08 12 13 17 00 00 00 08 0A 3F 16 2A 06 0C 0F 19 11 15 17 15 15 07 12 13 18
		//39 01 00 00 00 00 03 B6 33 33	//Vcom
		39 01 00 00 00 00 02 CC 02
		39 01 00 00 00 00 02 D2 11
		39 01 00 00 00 00 05 C7 00 00 00 C0
		39 01 00 00 00 00 04 C9 0F 00 19	//PWM 频率设置为30.8KHz
		39 01 00 00 00 00 02 35 00
		39 01 00 00 00 00 02 51 00
		39 01 00 00 00 00 02 53 24
		39 01 00 00 00 00 02 55 00
		05 01 00 00 78 00 02 11 00
		05 01 00 00 0A 00 02 29 00];
		qcom,mdss-dsi-off-command = [
		05 01 00 00 0a 00 02 28 00
		05 01 00 00 78 00 02 10 00];
		qcom,mdss-dsi-on-command-state = "dsi_lp_mode";
		qcom,mdss-dsi-off-command-state = "dsi_hs_mode";
		qcom,mdss-dsi-h-sync-pulse = <1>;
		qcom,mdss-dsi-traffic-mode = "burst_mode";
		qcom,mdss-dsi-lane-map = "lane_map_0123";
		qcom,mdss-dsi-bllp-eof-power-mode;
		qcom,mdss-dsi-bllp-power-mode;
		qcom,suspend-ulps-enabled;
		qcom,mdss-dsi-lane-0-state;
		qcom,mdss-dsi-lane-1-state;
		qcom,mdss-dsi-panel-timings = [6F 18 0E 00 38 3E 12 1E 13 03 04 00];
		qcom,mdss-dsi-t-clk-post = <0x05>;
		qcom,mdss-dsi-t-clk-pre = <0x18>;
		qcom,mdss-dsi-bl-min-level = <1>;
		qcom,mdss-dsi-bl-max-level = <255>;
		qcom,mdss-dsi-dma-trigger = "trigger_sw";
		qcom,mdss-dsi-mdp-trigger = "none";
		qcom,mdss-dsi-bl-pmic-control-type = "bl_ctrl_dcs";
		qcom,mdss-dsi-reset-sequence = <1 5>, <0 5>, <1 20>;
		qcom,mdss-dsi-lp11-init;
		qcom,mdss-dsi-init-delay-us = <7000>;
	};
};
