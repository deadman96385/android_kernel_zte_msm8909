/* Copyright (c) 2015, The Linux Foundation. All rights reserved.
 *
 * This program is free software; you can redistribute it and/or modify
 * it under the terms of the GNU General Public License version 2 and
 * only version 2 as published by the Free Software Foundation.
 *
 * This program is distributed in the hope that it will be useful,
 * but WITHOUT ANY WARRANTY; without even the implied warranty of
 * MERCHANTABILITY or FITNESS FOR A PARTICULAR PURPOSE.  See the
 * GNU General Public License for more details.
 */

&mdss_mdp {
	dsi_fl10802_fwvga_video: qcom,mdss_dsi_fl10802_fwvga_video {
		qcom,mdss-dsi-panel-name = "zteLEAD(FL10802)CPT_480*854_5.0Inch";
		qcom,mdss-dsi-panel-controller = <&mdss_dsi0>;
		qcom,mdss-dsi-panel-type = "dsi_video_mode";
		qcom,mdss-dsi-panel-destination = "display_1";
		qcom,cont-splash-enabled;
		qcom,mdss-dsi-panel-framerate = <60>;
		qcom,mdss-dsi-virtual-channel-id = <0>;
		qcom,mdss-dsi-stream = <0>;
		qcom,mdss-pan-physical-height-dimension = <110>;
		qcom,mdss-pan-physical-width-dimension = <62>;
		qcom,mdss-dsi-panel-width = <480>;
		qcom,mdss-dsi-panel-height = <854>;
		//qcom,mdss-dsi-h-front-porch = <70>;
		//qcom,mdss-dsi-h-back-porch = <80>;
		//qcom,mdss-dsi-h-pulse-width = <20>;
		//qcom,mdss-dsi-h-front-porch = <90>;  //modify mipi clk to 430M according to gaosong, 20160407
		//qcom,mdss-dsi-h-back-porch = <70>;
		//qcom,mdss-dsi-h-pulse-width = <32>;
		qcom,mdss-dsi-h-front-porch = <56>;
		qcom,mdss-dsi-h-back-porch = <10>;
		qcom,mdss-dsi-h-pulse-width = <4>;
		qcom,mdss-dsi-h-sync-skew = <0>;
		qcom,mdss-dsi-v-back-porch = <8>;
		qcom,mdss-dsi-v-front-porch = <12>;
		qcom,mdss-dsi-v-pulse-width = <4>;
		qcom,mdss-dsi-h-left-border = <0>;
		qcom,mdss-dsi-h-right-border = <0>;
		qcom,mdss-dsi-v-top-border = <0>;
		qcom,mdss-dsi-v-bottom-border = <0>;
		qcom,mdss-dsi-bpp = <24>;
		qcom,mdss-dsi-color-order = "rgb_swap_rgb";
		qcom,mdss-dsi-underflow-color = <0xff>;
		qcom,mdss-dsi-border-color = <0>;
		zte,lcd-backlight-min-value-limit;
		qcom,mdss-dsi-on-command = [
			29 00 00 00 00 00 04 B9 F1 08 01
			29 00 00 00 00 00 08 B1 2A 1A 1A 87 30 01 AB
			29 00 00 00 00 00 02 B2 22
			29 00 00 00 00 00 09 B3 01 00 06 06 18 13 39 35
			29 00 00 00 00 00 12 BA 31 00 44 25 91 0A 00 00 C1 00 00 00 0D 02 4F B9 EE
			29 00 00 00 00 00 06 E3 09 09 03 03 00
			29 00 00 00 00 00 02 B4 00
			29 00 00 00 00 00 03 B5 07 07
			29 00 00 00 00 00 03 B6 40 40 //flicker problem
			29 00 00 00 00 00 03 B8 64 22
			29 00 00 00 00 00 02 C7 A0 //backlight direction
			29 00 00 00 00 00 03 C8 10 00  //pwm frequency=30kHz
			29 00 00 00 00 00 02 CC 00
			29 00 00 00 00 00 02 BC 44
			29 00 00 00 00 00 34 E9 00 00 05 03 61 0A 70 10 01 00 37 09 0A 70 37 00
			00 18 00 00 00 25 09 80 40 00 42 60 00 00 00 09 81 50
			01 53 70 00 00 00 00 00 00 00 00 00 00 00 00 00 00
			29 00 00 00 00 00 13 EA 94 00 00 00 08 95 10 07 35 10 00 00 00 08 94 00 06 24
			29 00 00 00 00 00 23 E0 00 00 11 0F 10 2A 26 34 0C 0F 10 14 17 14 16 13 17 00 00 11 0F 10 2A 26 34 0C 0F 10 14 17 14 16 13 17
			29 00 00 00 00 00 02 53 24 /*add to open backlight*/
			05 01 00 00 78 00 02 11 00
			05 01 00 00 10 00 02 29 00];
		qcom,mdss-dsi-off-command = [
			29 00 00 00 00 00 02 53 00
			05 01 00 00 00 00 02 28 00
			05 01 00 00 28 00 02 10 00];
		qcom,mdss-dsi-on-command-state = "dsi_lp_mode";
		qcom,mdss-dsi-off-command-state = "dsi_hs_mode";
		qcom,mdss-dsi-h-sync-pulse = <1>;
		qcom,mdss-dsi-traffic-mode = "burst_mode";
		qcom,mdss-dsi-lane-map = "lane_map_0123";
		qcom,mdss-dsi-bllp-eof-power-mode;
		qcom,mdss-dsi-bllp-power-mode;
		qcom,suspend-ulps-enabled;
		qcom,mdss-dsi-lane-0-state;
		qcom,mdss-dsi-lane-1-state;
		//qcom,mdss-dsi-panel-timings =[7B 1A 10 00 3E 40 16 1E 15 03 04 00];
		//qcom,mdss-dsi-panel-timings =[7A 1A 12 00 3E 42 16 1E 14 03 04 00];
		//qcom,mdss-dsi-t-clk-post = <0x04>;
		//qcom,mdss-dsi-t-clk-pre = <0x1A>;
		qcom,mdss-dsi-panel-timings = [6A 16 0E 00 38 3A 12 1E 10 03 04 00];
		qcom,mdss-dsi-t-clk-post = <0x04>;
		qcom,mdss-dsi-t-clk-pre = <0x17>;
		qcom,mdss-dsi-bl-min-level = <1>;
		qcom,mdss-dsi-bl-max-level = <255>;
		qcom,mdss-dsi-dma-trigger = "trigger_sw";
		qcom,mdss-dsi-mdp-trigger = "none";
		qcom,mdss-dsi-bl-pmic-control-type = "bl_ctrl_dcs";
		qcom,mdss-dsi-reset-sequence = <1 5>, <0 5>, <1 20>;
		qcom,mdss-dsi-lp11-init;
		qcom,mdss-dsi-init-delay-us = <7000>;
		qcom,mdss-dsi-panel-status-command = [14 01 00 01 05 00 01 0A];
		qcom,mdss-dsi-panel-status-command-second  = [14 01 00 01 05 00 01 09];
		qcom,mdss-dsi-panel-status-value-second = <0x80>;
		qcom,mdss-dsi-panel-status-command-state = "dsi_lp_mode";
		qcom,mdss-dsi-panel-status-check-mode = "reg_read";
		qcom,mdss-dsi-panel-status-read-length = <1>;
		qcom,mdss-dsi-panel-status-value = <0x9c>;
		qcom,esd-check-enabled-second;
		qcom,esd-check-enabled;
	};
};
