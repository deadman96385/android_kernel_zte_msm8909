/* Copyright (c) 2015, The Linux Foundation. All rights reserved.
 *
 * This program is free software; you can redistribute it and/or modify
 * it under the terms of the GNU General Public License version 2 and
 * only version 2 as published by the Free Software Foundation.
 *
 * This program is distributed in the hope that it will be useful,
 * but WITHOUT ANY WARRANTY; without even the implied warranty of
 * MERCHANTABILITY or FITNESS FOR A PARTICULAR PURPOSE.  See the
 * GNU General Public License for more details.
 */

&mdss_mdp {
	dsi_jd9161_fwvga_video: qcom,mdss_dsi_jd9161_cpt_5p_fwvga_video {
		qcom,mdss-dsi-panel-name = "zteDIJING(jd9161)cpt_480*854_5.0Inch";
		qcom,mdss-dsi-panel-controller = <&mdss_dsi0>;
		qcom,mdss-dsi-panel-type = "dsi_video_mode";
		qcom,mdss-dsi-panel-destination = "display_1";
		qcom,mdss-dsi-panel-framerate = <60>;
		qcom,mdss-dsi-virtual-channel-id = <0>;
		qcom,mdss-dsi-stream = <0>;
		qcom,mdss-pan-physical-height-dimension = <110>;
		qcom,mdss-pan-physical-width-dimension = <62>;
		qcom,mdss-dsi-panel-width = <480>;
		qcom,mdss-dsi-panel-height = <854>;
		qcom,mdss-dsi-h-front-porch = <56>;
		qcom,mdss-dsi-h-back-porch = <10>;
		qcom,mdss-dsi-h-pulse-width = <4>;
		qcom,mdss-dsi-h-sync-skew = <0>;
		qcom,mdss-dsi-v-back-porch = <8>;
		qcom,mdss-dsi-v-front-porch = <12>;
		qcom,mdss-dsi-v-pulse-width = <4>;
		qcom,mdss-dsi-h-left-border = <0>;
		qcom,mdss-dsi-h-right-border = <0>;
		qcom,mdss-dsi-v-top-border = <0>;
		qcom,mdss-dsi-v-bottom-border = <0>;
		qcom,mdss-dsi-bpp = <24>;
		qcom,mdss-dsi-color-order = "rgb_swap_rgb";
		qcom,mdss-dsi-underflow-color = <0xff>;
		qcom,mdss-dsi-border-color = <0>;
		qcom,mdss-dsi-on-command = [
		39 01 00 00 00 00 04 BF 91 61 F2
		39 01 00 00 00 00 03 B3 00 63
		39 01 00 00 00 00 03 B4 00 63
		39 01 00 00 00 00 07 B8 00 B6 01 00 B6 01
		39 01 00 00 00 00 04 BA 34 23 00
		39 01 00 00 00 00 02 c3 04
		39 01 00 00 00 00 03 c4 30 6a
		39 01 00 00 00 00 0a C7 00 01 31 05 65 2C 13 A5 A5
		39 01 00 00 00 00 27 C8 79 58 4F 3A 35 24 24 0F 2B 2D
				31 55 4B 5C 56 5D 57 4F 41 79 58 4F 3A 35 24
				24 0F 2B 2D 31 55 4B 5C 56 5D 57 4F 41
		39 01 00 00 00 00 11 D4 1F 1E 1F 00 10 1F 1F 04 08 06
				0A 1F 1F 1F 1F 1F
		39 01 00 00 00 00 11 D5 1F 1E 1F 01 11 1F 1F 05 09 07
				0B 1F 1F 1F 1F 1F
		39 01 00 00 00 00 11 D6 1F 1F 1E 11 01 1F 1F 09 05 07
				0B 1F 1F 1F 1F 1F
		39 01 00 00 00 00 11 D7 1F 1F 1E 10 00 1F 1F 08 04 06
				0A 1F 1F 1F 1F 1F
		39 01 00 00 00 00 15 D8 20 02 0A 10 05 30 01 02 30 01
				02 06 70 53 61 73 09 06 70 08
		39 01 00 00 00 00 14 D9 00 0A 0A 88 00 00 06 7B 00 00
		00 3B 2F 1F 00 00 00 03 7B
		39 01 00 00 00 00 02 BE 01
		39 01 00 00 00 00 02 c1 10
		39 01 00 00 00 00 0b CC 34 20 38 60 11 91 00 40 00 00
		39 01 00 00 00 00 02 BE 00
		39 01 00 00 00 00 02 51 00
		39 01 00 00 00 00 02 53 2c
		05 01 00 00 78 00 02 11 00
		05 01 00 00 0a 00 02 29 00 ];
		qcom,mdss-dsi-off-command = [
			/*tzb close backlight quickly when sleep in, 20170223*/
			39 01 00 00 78 00 02 53 00
			05 01 00 00 00 00 02 28 00
			05 01 00 00 28 00 02 10 00
			];
		qcom,mdss-dsi-on-command-state = "dsi_lp_mode";
		qcom,mdss-dsi-off-command-state = "dsi_hs_mode";
		qcom,mdss-dsi-h-sync-pulse = <1>;
		qcom,mdss-dsi-traffic-mode = "burst_mode";
		qcom,mdss-dsi-lane-map = "lane_map_0123";
		qcom,mdss-dsi-bllp-eof-power-mode;
		qcom,mdss-dsi-bllp-power-mode;
		qcom,suspend-ulps-enabled;
		qcom,mdss-dsi-lane-0-state;
		qcom,mdss-dsi-lane-1-state;
		qcom,mdss-dsi-panel-timings = [6A 16 0E 00 38 3A 12 1E 10 03 04 00];
		qcom,mdss-dsi-t-clk-post = <0x04>;
		qcom,mdss-dsi-t-clk-pre = <0x17>;
		qcom,mdss-dsi-bl-min-level = <1>;
		qcom,mdss-dsi-bl-max-level = <255>;
		qcom,mdss-dsi-dma-trigger = "trigger_sw";
		qcom,mdss-dsi-mdp-trigger = "none";
		qcom,mdss-dsi-bl-pmic-control-type = "bl_ctrl_dcs";
		qcom,mdss-dsi-reset-sequence = <1 20>, <0 5>, <1 20>;
		qcom,mdss-dsi-lp11-init;
		qcom,mdss-dsi-init-delay-us = <7000>;
	};
};
