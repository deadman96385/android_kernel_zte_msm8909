/* Copyright (c) 2012, Code Aurora Forum. All rights reserved.
 *
 * This program is free software; you can redistribute it and/or modify
 * it under the terms of the GNU General Public License version 2 and
 * only version 2 as published by the Free Software Foundation.
 *
 * This program is distributed in the hope that it will be useful,
 * but WITHOUT ANY WARRANTY; without even the implied warranty of
 * MERCHANTABILITY or FITNESS FOR A PARTICULAR PURPOSE.  See the
 * GNU General Public License for more details.
 */

/*---------------------------------------------------------------------------
* This file is autogenerated file using gcdb parser. Please do not edit it.
* Update input XML file to add a new entry or update variable in this file
* VERSION = "1.0"
*file name:dsi-panel-zte-lead-nt35521-cpt-5p5-720p-video.h
*author   :created by tangzhengbo at 20150109
*---------------------------------------------------------------------------*/
&mdss_mdp {

		dsi_dijing_nt35521_cmi_5p5_720p_video: qcom,mdss_dsi_dijing_nt35521_cmi_5p5_720p_video{
		qcom,mdss-dsi-panel-name =  "zteDIJING(NT35521)CMI_720*1280_5.5Inch";
		qcom,cont-splash-enabled;
		qcom,mdss-dsi-panel-controller = <&mdss_dsi0>;
		qcom,mdss-dsi-panel-type = "dsi_video_mode";
		qcom,mdss-dsi-panel-destination = "display_1";
		qcom,mdss-dsi-panel-framerate = <60>;
		qcom,mdss-dsi-virtual-channel-id = <0>;
		qcom,mdss-dsi-stream = <0>;
		qcom,mdss-pan-physical-height-dimension = <121>;
		qcom,mdss-pan-physical-width-dimension = <68>;
		qcom,mdss-dsi-panel-width = <720>;
		qcom,mdss-dsi-panel-height = <1280>;
		qcom,mdss-dsi-h-front-porch = <40>;//mipi clk=389.34M
		qcom,mdss-dsi-h-back-porch = <35>;
		qcom,mdss-dsi-h-pulse-width =  <20>;
		qcom,mdss-dsi-h-sync-skew = <0>;
		qcom,mdss-dsi-v-front-porch = <20>;
		qcom,mdss-dsi-v-back-porch = <15>;
		qcom,mdss-dsi-v-pulse-width = <12>;
		qcom,mdss-dsi-h-left-border = <0>;
		qcom,mdss-dsi-h-right-border = <0>;
		qcom,mdss-dsi-v-top-border = <0>;
		qcom,mdss-dsi-v-bottom-border = <0>;
		qcom,mdss-dsi-bpp = <24>;
		qcom,mdss-dsi-color-order = <0>;
		qcom,mdss-dsi-underflow-color = <0xff>;
		qcom,mdss-dsi-border-color = <0>;
		qcom,mdss-dsi-h-sync-pulse = <0>;
		qcom,mdss-dsi-traffic-mode = <1>;
		qcom,mdss-dsi-lane-map = "lane_map_0123";
		qcom,mdss-dsi-bllp-eof-power-mode;
		qcom,mdss-dsi-bllp-power-mode;
		qcom,suspend-ulps-enabled;
		qcom,mdss-dsi-lane-0-state;
		qcom,mdss-dsi-lane-1-state;
		qcom,mdss-dsi-lane-2-state;
		qcom,mdss-dsi-lane-3-state;
		qcom,mdss-dsi-lp11-init;
		qcom,mdss-dsi-panel-timings =[76 18 10 00 3a 3e 14 1c 12 03 04 a0];
		qcom,mdss-dsi-t-clk-post = <0x04>;
		qcom,mdss-dsi-t-clk-pre = <0x19>;
		qcom,mdss-dsi-bl-min-level = <1>;
		qcom,mdss-dsi-bl-max-level = <255>;
		qcom,mdss-dsi-dma-trigger = <0x04>;
		qcom,mdss-dsi-mdp-trigger = <0x0>;
		qcom,mdss-dsi-bl-pmic-control-type = "bl_ctrl_dcs";
		//qcom,mdss-dsi-bl-cmd-gpio = <&msmgpio 33 0>;
		qcom,mdss-dsi-reset-sequence = <1 5>, <0 5>, <1 20>;
		qcom,mdss-dsi-on-command= [
				39 01 00 00 00 00 05 FF AA 55 25 01
				39 01 00 00 00 00 02 FC 08
				39 01 00 00 00 00 02 FC 00
				39 01 00 00 00 00 02 6F 21
				39 01 00 00 00 00 02 F7 01
				39 01 00 00 00 00 02 6F 21
				39 01 00 00 00 00 02 F7 00
				39 01 00 00 00 00 05 FF AA 55 25 00
				39 01 00 00 00 00 06 F0 55 AA 52 08 00
				39 01 00 00 00 00 02 C8 80
				39 01 00 00 00 00 03 B1 60 21
				39 01 00 00 00 00 02 B6 10
				39 01 00 00 00 00 05 B8 00 00 00 00
				39 01 00 00 00 00 02 C6 31
				39 01 00 00 00 00 03 D9 03 06    //PWM=32.5K
				39 01 00 00 00 00 03 BC 00 00
				39 01 00 00 00 00 06 BD 02 B0 1E 1E 00
				39 01 00 00 00 00 06 F0 55 AA 52 08 01
				39 01 00 00 00 00 02 c0 04
				39 01 00 00 00 00 03 B9 45 45
				39 01 00 00 00 00 03 B3 2D 2D
				39 01 00 00 00 00 03 BA 26 26
				39 01 00 00 00 00 03 B4 19 19
				39 01 00 00 00 00 03 BC 90 00
				39 01 00 00 00 00 03 BD 90 00
				39 01 00 00 00 00 06 F0 55 AA 52 08 02
				39 01 00 00 00 00 02 ED 03
				39 01 00 00 00 00 02 EE 01

				39 01 00 00 00 00 11 B0 00 00 00 4A 00 77 00 92 00 A9 00 CC 00 E8 01 15
				39 01 00 00 00 00 11 B1 01 38 01 6F 01 9A 01 DE 02 15 02 16 02 48 02 82
				39 01 00 00 00 00 11 B2 02 A5 02 D4 02 F3 03 1C 03 36 03 56 03 68 03 7C
				39 01 00 00 00 00 05 B3 03 FD 03 FF

				39 01 00 00 00 00 06 F0 55 AA 52 08 06
				39 01 00 00 00 00 03 B0 29 2A
				39 01 00 00 00 00 03 B1 10 12
				39 01 00 00 00 00 03 B2 14 16
				39 01 00 00 00 00 03 B3 18 1A
				39 01 00 00 00 00 03 B4 08 0A
				39 01 00 00 00 00 03 B5 34 34
				39 01 00 00 00 00 03 B6 34 34
				39 01 00 00 00 00 03 B7 34 34
				39 01 00 00 00 00 03 B8 34 00
				39 01 00 00 00 00 03 B9 34 34

				39 01 00 00 00 00 03 BA 34 34
				39 01 00 00 00 00 03 BB 01 34
				39 01 00 00 00 00 03 BC 2E 34
				39 01 00 00 00 00 03 BD 34 34
				39 01 00 00 00 00 03 BE 34 34
				39 01 00 00 00 00 03 BF 0B 09
				39 01 00 00 00 00 03 C0 1B 19
				39 01 00 00 00 00 03 C1 17 15
				39 01 00 00 00 00 03 C2 13 11
				39 01 00 00 00 00 03 C3 2A 29
				39 01 00 00 00 00 03 E5 2E 2E

				39 01 00 00 00 00 03 C4 29 2A
				39 01 00 00 00 00 03 C5 17 15
				39 01 00 00 00 00 03 C6 13 11
				39 01 00 00 00 00 03 C7 1B 19
				39 01 00 00 00 00 03 C8 01 0B
				39 01 00 00 00 00 03 C9 34 34
				39 01 00 00 00 00 03 CA 34 34
				39 01 00 00 00 00 03 CB 34 34
				39 01 00 00 00 00 03 CC 34 09
				39 01 00 00 00 00 03 CD 34 34

				39 01 00 00 00 00 03 CE 34 34
				39 01 00 00 00 00 03 CF 08 34
				39 01 00 00 00 00 03 D0 2E 34
				39 01 00 00 00 00 03 D1 34 34
				39 01 00 00 00 00 03 D2 34 34
				39 01 00 00 00 00 03 D3 0A 00
				39 01 00 00 00 00 03 D4 18 1A
				39 01 00 00 00 00 03 D5 10 12
				39 01 00 00 00 00 03 D6 14 16
				39 01 00 00 00 00 03 D7 2A 29
				39 01 00 00 00 00 03 E6 2E 2E
				39 01 00 00 00 00 06 D8 00 00 00 00 00
				39 01 00 00 00 00 06 D9 00 00 00 00 00
				39 01 00 00 00 00 02 E7 00

				39 01 00 00 00 00 06 F0 55 AA 52 08 03
				39 01 00 00 00 00 03 B0 00 00
				39 01 00 00 00 00 03 B1 00 00
				39 01 00 00 00 00 06 B2 05 00 00 00 00
				39 01 00 00 00 00 06 B6 05 00 00 00 00
				39 01 00 00 00 00 06 B7 05 00 00 00 00
				39 01 00 00 00 00 06 BA 57 00 00 00 00
				39 01 00 00 00 00 06 BB 57 00 00 00 00
				39 01 00 00 00 00 05 C0 00 00 00 00
				39 01 00 00 00 00 05 C1 00 00 00 00
				39 01 00 00 00 00 02 C4 60
				39 01 00 00 00 00 02 C5 40

				39 01 00 00 00 00 06 F0 55 AA 52 08 05
				39 01 00 00 00 00 06 BD 03 01 03 03 03
				39 01 00 00 00 00 03 B0 17 06
				39 01 00 00 00 00 03 B1 17 06
				39 01 00 00 00 00 03 B2 17 06
				39 01 00 00 00 00 03 B3 17 06
				39 01 00 00 00 00 03 B4 17 06
				39 01 00 00 00 00 03 B5 17 06
				39 01 00 00 00 00 02 B8 00
				39 01 00 00 00 00 02 B9 00
				39 01 00 00 00 00 02 BA 00
				39 01 00 00 00 00 02 BB 02
				39 01 00 00 00 00 02 BC 00

				39 01 00 00 00 00 02 C0 05
				39 01 00 00 00 00 02 C4 82
				39 01 00 00 00 00 02 C5 A2
				39 01 00 00 00 00 03 C8 03 30
				39 01 00 00 00 00 03 C9 03 31
				39 01 00 00 00 00 04 CC 00 00 3C
				39 01 00 00 00 00 04 CD 00 00 3C

				39 01 00 00 00 00 06 D1 00 05 0B 00 00
				39 01 00 00 00 00 06 D2 00 25 08 00 00

				39 01 00 00 00 00 02 E5 06
				39 01 00 00 00 00 02 E6 06
				39 01 00 00 00 00 02 E7 06
				39 01 00 00 00 00 02 E8 06
				39 01 00 00 00 00 02 E9 06
				39 01 00 00 00 00 02 EA 06
				39 01 00 00 00 00 02 ED 33

				//39 00 00 00 00 00 02 51 ff
				39 00 00 00 00 00 02 53 2c
				39 01 00 00 00 00 02 55 00

				05 01 00 00 78 00 02 11 00
				05 01 00 00 0a 00 02 29 00
		];
		qcom,mdss-dsi-on-command-state = "dsi_lp_mode";
		qcom,mdss-dsi-off-command = [
		05 01 00 00 00 00 02 28 00
		05 01 00 00 78 00 02 10 00
		15 01 00 00 00 00 02 4f 01];
		qcom,mdss-dsi-off-command-state = "dsi_hs_mode";
	};
};
