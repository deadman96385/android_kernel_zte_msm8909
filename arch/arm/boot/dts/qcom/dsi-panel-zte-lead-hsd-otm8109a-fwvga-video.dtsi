/* Copyright (c) 2015, The Linux Foundation. All rights reserved.
 *
 * This program is free software; you can redistribute it and/or modify
 * it under the terms of the GNU General Public License version 2 and
 * only version 2 as published by the Free Software Foundation.
 *
 * This program is distributed in the hope that it will be useful,
 * but WITHOUT ANY WARRANTY; without even the implied warranty of
 * MERCHANTABILITY or FITNESS FOR A PARTICULAR PURPOSE.  See the
 * GNU General Public License for more details.
 */

&mdss_mdp {
	dsi_otm8019a_fwvga_video: qcom,zte-lead-otm8019a-fwvga-video {
		qcom,mdss-dsi-panel-name = "zteLEAD(OTM8019A)HSD_480*854_5.0Inch";
		qcom,mdss-dsi-panel-controller = <&mdss_dsi0>;
		qcom,mdss-dsi-panel-type = "dsi_video_mode";
		qcom,mdss-dsi-panel-destination = "display_1";
		qcom,cont-splash-enabled;
		qcom,mdss-dsi-panel-framerate = <60>;
		qcom,mdss-dsi-virtual-channel-id = <0>;
		qcom,mdss-dsi-stream = <0>;
		qcom,mdss-pan-physical-height-dimension = <110>;
		qcom,mdss-pan-physical-width-dimension = <62>;
		qcom,mdss-dsi-panel-width = <480>;
		qcom,mdss-dsi-panel-height = <854>;
		qcom,mdss-dsi-h-front-porch = <94>;
		qcom,mdss-dsi-h-back-porch = <84>;
		qcom,mdss-dsi-h-pulse-width = <59>;
		qcom,mdss-dsi-h-sync-skew = <0>;
		qcom,mdss-dsi-v-back-porch = <12>;
		qcom,mdss-dsi-v-front-porch = <18>;
		qcom,mdss-dsi-v-pulse-width = <4>;
		qcom,mdss-dsi-h-left-border = <0>;
		qcom,mdss-dsi-h-right-border = <0>;
		qcom,mdss-dsi-v-top-border = <0>;
		qcom,mdss-dsi-v-bottom-border = <0>;
		qcom,mdss-dsi-bpp = <24>;
		qcom,mdss-dsi-color-order = "rgb_swap_rgb";
		qcom,mdss-dsi-underflow-color = <0xff>;
		qcom,mdss-dsi-border-color = <0>;
		qcom,mdss-dsi-on-command = [
				39 01 00 00 00 00 02 00 00
				39 01 00 00 00 00 04 FF 80 19 01
				39 01 00 00 00 00 02 00 80
				39 01 00 00 00 00 03 FF 80 19
				39 01 00 00 00 00 02 00 B4
				39 01 00 00 00 00 02 C0 70
				39 01 00 00 00 00 02 00 81
				39 01 00 00 00 00 02 C5 66
				39 01 00 00 00 00 02 00 82
				39 01 00 00 00 00 02 C5 B0
				39 01 00 00 00 00 02 00 90
				39 01 00 00 00 00 03 C5 4E 09
				39 01 00 00 00 00 02 00 00
				39 01 00 00 00 00 03 D8 69 69
				39 01 00 00 00 00 02 00 00
				39 01 00 00 00 00 02 D9 3A
				39 01 00 00 00 00 02 00 81
				39 01 00 00 00 00 02 C1 33
				39 01 00 00 00 00 02 00 A1
				39 01 00 00 00 00 02 C1 08
				39 01 00 00 00 00 02 00 81
				39 01 00 00 00 00 02 C4 83
				39 01 00 00 00 00 02 00 B1
				39 01 00 00 00 00 02 C5 A9
				39 01 00 00 00 00 02 00 93
				39 01 00 00 00 00 02 C5 03
				39 01 00 00 00 00 02 00 92
				39 01 00 00 00 00 02 B3 40
				39 01 00 00 00 00 02 00 90
				39 01 00 00 00 00 02 B3 02
				39 01 00 00 00 00 02 00 80
				39 01 00 00 00 00 0A C0 00 58 00 15 15 00 58 15 15
				39 01 00 00 00 00 02 00 90
				39 01 00 00 00 00 07 C0 00 15 00 00 00 03
				39 01 00 00 00 00 02 00 80
				39 01 00 00 00 00 0D CE 8B 03 00 8A 03 00 89 03 00 88 03 00
				39 01 00 00 00 00 02 00 A0
				39 01 00 00 00 00 0F CE 38 07 03 54 00 02 00 38 06 03 55 00 02 00
				39 01 00 00 00 00 02 00 B0
				39 01 00 00 00 00 0F CE 38 05 03 56 00 02 00 38 04 03 57 00 02 00
				39 01 00 00 00 00 02 00 C0
				39 01 00 00 00 00 0F CE 38 03 03 58 00 02 00 38 02 03 59 00 02 00
				39 01 00 00 00 00 02 00 D0
				39 01 00 00 00 00 0F CE 38 01 03 5A 00 02 00 38 00 03 5B 00 02 00
				39 01 00 00 00 00 02 00 C0
				39 01 00 00 00 00 0B CF 02 02 00 00 00 00 01 00 00 00
				39 01 00 00 00 00 02 00 90
				39 01 00 00 00 00 10 CB 00 00 00 00 00 00 00 00 00 00 00 00 00 00 00
				39 01 00 00 00 00 02 00 A0
				39 01 00 00 00 00 02 CB 00
				39 01 00 00 00 00 02 00 A5
				39 01 00 00 00 00 0B CB 00 00 00 00 00 00 00 00 00 00
				39 01 00 00 00 00 02 00 B0
				39 01 00 00 00 00 07 CB 00 00 00 00 00 00
				39 01 00 00 00 00 02 00 C0
				39 01 00 00 00 00 10 CB 01 01 01 01 01 01 01 01 01 01 00 00 00 00 00
				39 01 00 00 00 00 02 00 D0
				39 01 00 00 00 00 02 CB 00
				39 01 00 00 00 00 02 00 D5
				39 01 00 00 00 00 0B CB 00 00 00 00 00 00 01 01 01 01
				39 01 00 00 00 00 02 00 E0
				39 01 00 00 00 00 07 CB 01 01 01 01 01 01
				39 01 00 00 00 00 02 00 80
				39 01 00 00 00 00 0B CC 26 25 21 22 0C 0A 10 0E 02 04
				39 01 00 00 00 00 02 00 90
				39 01 00 00 00 00 10 CC 00 00 00 00 00 00 00 00 00 00 00 00 00 00 00
				39 01 00 00 00 00 02 00 A0
				39 01 00 00 00 00 0C CC 00 03 01 0D 0F 09 0B 22 21 25 26
				39 01 00 00 00 00 02 00 B0
				39 01 00 00 00 00 0B CC 25 26 21 22 10 0A 0C 0E 04 02
				39 01 00 00 00 00 02 00 C0
				39 01 00 00 00 00 07 CC 00 00 00 00 00 00
				39 01 00 00 00 00 02 00 CA
				39 01 00 00 00 00 06 CC 00 00 00 00 00
				39 01 00 00 00 00 02 00 D0
				39 01 00 00 00 00 0C CC 00 01 03 0D 0B 09 0F 22 21 26 25
				39 01 00 00 00 00 02 00 00
				39 01 00 00 00 00 15 E1 00 02 06 11 24 38 41 75 67 7F 86 74 8B 75 79 71 69 58 4D 00
				39 01 00 00 00 00 02 00 00
				39 01 00 00 00 00 15 E2 00 02 06 11 24 38 41 75 68 7F 86 74 8B 74 79 70 68 58 4E 00
				39 01 00 00 00 00 02 00 80
				39 01 00 00 00 00 02 C4 30
				39 01 00 00 00 00 02 00 98
				39 01 00 00 00 00 02 C0 00
				39 01 00 00 00 00 02 00 A9
				39 01 00 00 00 00 02 C0 0A
				39 01 00 00 00 00 02 00 B0
				39 01 00 00 00 00 04 C1 20 00 00
				39 01 00 00 00 00 02 00 E1
				39 01 00 00 00 00 03 C0 40 30
				39 01 00 00 00 00 02 00 80
				39 01 00 00 00 00 03 C1 03 33
				39 01 00 00 00 00 02 00 A0
				39 01 00 00 00 00 02 C1 E8
				39 01 00 00 00 00 02 00 90
				39 01 00 00 00 00 02 B6 B4
				39 01 00 00 00 00 02 00 00
				39 01 00 00 00 00 02 FB 01
				39 01 00 00 00 00 02 00 00
				39 01 00 00 00 00 04 FF FF FF FF
				39 01 00 00 05 00 02 53 24
				39 01 00 00 05 00 02 55 00
				05 01 00 00 96 00 02 11 00
				05 01 00 00 14 00 02 29 00
			];
		qcom,mdss-dsi-off-command = [
				05 01 00 00 00 00 02 28 00
				05 01 00 00 28 00 02 10 00];
		qcom,mdss-dsi-on-command-state = "dsi_lp_mode";
		qcom,mdss-dsi-off-command-state = "dsi_hs_mode";
		qcom,mdss-dsi-h-sync-pulse = <1>;
		qcom,mdss-dsi-traffic-mode = "burst_mode";
		qcom,mdss-dsi-lane-map = "lane_map_0123";
		qcom,mdss-dsi-bllp-eof-power-mode;
		qcom,mdss-dsi-bllp-power-mode;
		qcom,suspend-ulps-enabled;
		qcom,mdss-dsi-lane-0-state;
		qcom,mdss-dsi-lane-1-state;
		qcom,mdss-dsi-hfp-power-mode;
		qcom,mdss-dsi-hbp-power-mode;
		qcom,mdss-dsi-hsa-power-mode;
	       qcom,mdss-dsi-panel-timings =[87 1c 12 00 42 44 18 20 17 03 04 00];
		qcom,mdss-dsi-t-clk-post = <0x04>;
		qcom,mdss-dsi-t-clk-pre = <0x1B>;
		qcom,mdss-dsi-bl-min-level = <1>;
		qcom,mdss-dsi-bl-max-level = <255>;
		qcom,mdss-dsi-dma-trigger = "trigger_sw";
		qcom,mdss-dsi-mdp-trigger = "none";
		qcom,mdss-dsi-bl-pmic-control-type = "bl_ctrl_dcs";
		qcom,mdss-dsi-reset-sequence = <1 5>, <0 5>, <1 20>;
		qcom,mdss-dsi-lp11-init;
		qcom,mdss-dsi-init-delay-us = <7000>;
	};
};
