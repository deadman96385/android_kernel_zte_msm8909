/* Copyright (c) 2015, The Linux Foundation. All rights reserved.
 *
 * This program is free software; you can redistribute it and/or modify
 * it under the terms of the GNU General Public License version 2 and
 * only version 2 as published by the Free Software Foundation.
 *
 * This program is distributed in the hope that it will be useful,
 * but WITHOUT ANY WARRANTY; without even the implied warranty of
 * MERCHANTABILITY or FITNESS FOR A PARTICULAR PURPOSE.  See the
 * GNU General Public License for more details.
 */

&mdss_mdp {
	dsi_skyworth_ili9806e_fwvga_video: qcom,mdss_dsi_skyworth_ili9806e_cpt_5p_fwvga_video {
		qcom,mdss-dsi-panel-name = "zteSKYWORTH_ili9806e_cpt_480_854_5.0Inch";
		qcom,mdss-dsi-panel-controller = <&mdss_dsi0>;
		qcom,mdss-dsi-panel-type = "dsi_video_mode";
		qcom,mdss-dsi-panel-destination = "display_1";
		qcom,mdss-dsi-panel-framerate = <60>;
		qcom,mdss-dsi-virtual-channel-id = <0>;
		qcom,mdss-dsi-stream = <0>;
		qcom,mdss-pan-physical-height-dimension = <110>;
		qcom,mdss-pan-physical-width-dimension = <62>;
		qcom,mdss-dsi-panel-width = <480>;
		qcom,mdss-dsi-panel-height = <854>;
		qcom,mdss-dsi-h-front-porch = <60>; /* mipi = 392.64M */
		qcom,mdss-dsi-h-back-porch = <60>;
		qcom,mdss-dsi-h-pulse-width = <10>;
		qcom,mdss-dsi-h-sync-skew = <0>;
		qcom,mdss-dsi-v-back-porch = <16>;
		qcom,mdss-dsi-v-front-porch = <20>;
		qcom,mdss-dsi-v-pulse-width = <4>;
		qcom,mdss-dsi-h-left-border = <0>;
		qcom,mdss-dsi-h-right-border = <0>;
		qcom,mdss-dsi-v-top-border = <0>;
		qcom,mdss-dsi-v-bottom-border = <0>;
		qcom,mdss-dsi-bpp = <24>;
		qcom,mdss-dsi-color-order = "rgb_swap_rgb";
		qcom,mdss-dsi-underflow-color = <0xff>;
		qcom,mdss-dsi-border-color = <0>;
		qcom,mdss-dsi-on-command = [
			39 01 00 00 00 00 06 FF FF 98 06 04 01
			39 01 00 00 00 00 02 08 10
			39 01 00 00 00 00 02 21 01
			39 01 00 00 00 00 02 30 01
			39 01 00 00 00 00 02 31 02
			39 01 00 00 00 00 02 60 07
			39 01 00 00 00 00 02 61 00
			39 01 00 00 00 00 02 62 07
			39 01 00 00 00 00 02 63 00

			39 01 00 00 00 00 02 40 10
			39 01 00 00 00 00 02 41 44
			39 01 00 00 00 00 02 42 03

			39 01 00 00 00 00 02 43 09
			39 01 00 00 00 00 02 44 06

			39 01 00 00 00 00 02 45 04
			39 01 00 00 00 00 02 50 78
			39 01 00 00 00 00 02 51 78
			39 01 00 00 00 00 02 52 00
			39 01 00 00 00 00 02 53 30
			39 01 00 00 00 00 02 A0 00
			39 01 00 00 00 00 02 A1 0c
			39 01 00 00 00 00 02 A2 19
			39 01 00 00 00 00 02 A3 11
			39 01 00 00 00 00 02 A4 0A
			39 01 00 00 00 00 02 A5 19
			39 01 00 00 00 00 02 A6 08
			39 01 00 00 00 00 02 A7 08
			39 01 00 00 00 00 02 A8 03
			39 01 00 00 00 00 02 A9 09
			39 01 00 00 00 00 02 AA 05
			39 01 00 00 00 00 02 AB 00
			39 01 00 00 00 00 02 AC 08
			39 01 00 00 00 00 02 AD 30
			39 01 00 00 00 00 02 AE 2B
			39 01 00 00 00 00 02 AF 00

			39 01 00 00 00 00 02 C0 00
			39 01 00 00 00 00 02 C1 0B
			39 01 00 00 00 00 02 C2 17
			39 01 00 00 00 00 02 C3 10
			39 01 00 00 00 00 02 C4 0A
			39 01 00 00 00 00 02 C5 14
			39 01 00 00 00 00 02 C6 0B
			39 01 00 00 00 00 02 C7 08
			39 01 00 00 00 00 02 C8 03
			39 01 00 00 00 00 02 C9 09
			39 01 00 00 00 00 02 CA 08
			39 01 00 00 00 00 02 CB 06
			39 01 00 00 00 00 02 CC 0D
			39 01 00 00 00 00 02 CD 27
			39 01 00 00 00 00 02 CE 23
			39 01 00 00 00 00 02 CF 00

			39 01 00 00 00 00 06 FF FF 98 06 04 06
			39 01 00 00 00 00 02 00 21
			39 01 00 00 00 00 02 01 04
			39 01 00 00 00 00 02 02 00
			39 01 00 00 00 00 02 03 00
			39 01 00 00 00 00 02 04 16
			39 01 00 00 00 00 02 05 16
			39 01 00 00 00 00 02 06 80
			39 01 00 00 00 00 02 07 02
			39 01 00 00 00 00 02 08 07
			39 01 00 00 00 00 02 09 90
			39 01 00 00 00 00 02 0A 01
			39 01 00 00 00 00 02 0B 06
			39 01 00 00 00 00 02 0C 15
			39 01 00 00 00 00 02 0D 15
			39 01 00 00 00 00 02 0E 00
			39 01 00 00 00 00 02 0F 00
			39 01 00 00 00 00 02 10 77
			39 01 00 00 00 00 02 11 f0
			39 01 00 00 00 00 02 12 00
			39 01 00 00 00 00 02 13 87
			39 01 00 00 00 00 02 14 87
			39 01 00 00 00 00 02 15 C0
			39 01 00 00 00 00 02 16 08
			39 01 00 00 00 00 02 17 00
			39 01 00 00 00 00 02 18 00
			39 01 00 00 00 00 02 19 00
			39 01 00 00 00 00 02 1A 00
			39 01 00 00 00 00 02 1B 00
			39 01 00 00 00 00 02 1C 00
			39 01 00 00 00 00 02 1D 00

			39 01 00 00 00 00 02 20 01
			39 01 00 00 00 00 02 21 23
			39 01 00 00 00 00 02 22 45
			39 01 00 00 00 00 02 23 67
			39 01 00 00 00 00 02 24 01
			39 01 00 00 00 00 02 25 23
			39 01 00 00 00 00 02 26 45
			39 01 00 00 00 00 02 27 67

			39 01 00 00 00 00 02 30 11
			39 01 00 00 00 00 02 31 22
			39 01 00 00 00 00 02 32 11
			39 01 00 00 00 00 02 33 00
			39 01 00 00 00 00 02 34 66
			39 01 00 00 00 00 02 35 88
			39 01 00 00 00 00 02 36 22
			39 01 00 00 00 00 02 37 22
			39 01 00 00 00 00 02 38 AA
			39 01 00 00 00 00 02 39 CC
			39 01 00 00 00 00 02 3A BB
			39 01 00 00 00 00 02 3B DD
			39 01 00 00 00 00 02 3C 22
			39 01 00 00 00 00 02 3D 22
			39 01 00 00 00 00 02 3E 22
			39 01 00 00 00 00 02 3F 22
			39 01 00 00 00 00 02 40 22
			39 01 00 00 00 00 02 52 10
			39 01 00 00 00 00 02 53 10

			39 01 00 00 00 00 06 FF FF 98 06 04 07
			39 01 00 00 00 00 02 17 22
			39 01 00 00 00 00 02 02 77
			39 01 00 00 00 00 02 E1 79
			39 01 00 00 00 00 02 06 13

			39 01 00 00 00 00 06 FF FF 98 06 04 00
			39 01 00 00 00 00 02 51 00
			39 01 00 00 00 00 02 53 2c

			39 01 00 00 00 00 06 FF FF 98 06 04 05
			39 01 00 00 00 00 02 00 01   //35.29KHz
			39 01 00 00 00 00 06 FF FF 98 06 04 00
			39 01 00 00 00 00 02 35 00


			05 01 00 00 78 00 02 11 00
			05 01 00 00 14 00 02 29 00
		];
		qcom,mdss-dsi-off-command = [
			/*tzb close backlight quickly when sleep in, 20170223*/
			39 01 00 00 78 00 02 53 00
			05 01 00 00 00 00 02 28 00
			05 01 00 00 28 00 02 10 00
		];
		qcom,mdss-dsi-on-command-state = "dsi_lp_mode";
		qcom,mdss-dsi-off-command-state = "dsi_hs_mode";
		qcom,mdss-dsi-h-sync-pulse = <1>;
		qcom,mdss-dsi-traffic-mode = "burst_mode";
		qcom,mdss-dsi-lane-map = "lane_map_0123";
		qcom,mdss-dsi-bllp-eof-power-mode;
		qcom,mdss-dsi-bllp-power-mode;
		qcom,suspend-ulps-enabled;
		qcom,mdss-dsi-lane-0-state;
		qcom,mdss-dsi-lane-1-state;
		qcom,mdss-dsi-panel-timings = [76 18 10 00 3c 3e 14 1c 12 03 04 00];
		qcom,mdss-dsi-t-clk-post = <0x04>;
		qcom,mdss-dsi-t-clk-pre = <0x19>;
		qcom,mdss-dsi-bl-min-level = <1>;
		qcom,mdss-dsi-bl-max-level = <255>;
		qcom,mdss-dsi-dma-trigger = "trigger_sw";
		qcom,mdss-dsi-mdp-trigger = "none";
		qcom,mdss-dsi-bl-pmic-control-type = "bl_ctrl_dcs";
		qcom,mdss-dsi-reset-sequence = <1 20>, <0 5>, <1 20>;
		qcom,mdss-dsi-lp11-init;
		qcom,mdss-dsi-init-delay-us = <7000>;
	};
};
