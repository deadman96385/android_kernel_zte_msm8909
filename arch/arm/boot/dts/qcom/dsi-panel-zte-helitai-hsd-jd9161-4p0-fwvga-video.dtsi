/* Copyright (c) 2015, The Linux Foundation. All rights reserved.
 *
 * This program is free software; you can redistribute it and/or modify
 * it under the terms of the GNU General Public License version 2 and
 * only version 2 as published by the Free Software Foundation.
 *
 * This program is distributed in the hope that it will be useful,
 * but WITHOUT ANY WARRANTY; without even the implied warranty of
 * MERCHANTABILITY or FITNESS FOR A PARTICULAR PURPOSE.  See the
 * GNU General Public License for more details.
 */

&mdss_mdp {
	dsi_hlt_jd9161_4p_fwvga_video: qcom,mdss_dsi_hlt_jd9161_hsd_4p_fwvga_video {
		qcom,mdss-dsi-panel-name = "zteHELITAI_jd9161_hsd_480_800_4p0Inch";
		qcom,mdss-dsi-panel-controller = <&mdss_dsi0>;
		qcom,mdss-dsi-panel-type = "dsi_video_mode";
		qcom,mdss-dsi-panel-destination = "display_1";
		qcom,mdss-dsi-panel-framerate = <60>;
		qcom,mdss-dsi-virtual-channel-id = <0>;
		qcom,mdss-dsi-stream = <0>;
		qcom,mdss-pan-physical-height-dimension = <110>;
		qcom,mdss-pan-physical-width-dimension = <62>;
		qcom,mdss-dsi-panel-width = <480>;
		qcom,mdss-dsi-panel-height = <800>;
		qcom,mdss-dsi-h-front-porch = <8>; /* mipi = 349.67M */
		qcom,mdss-dsi-h-back-porch = <8>;
		qcom,mdss-dsi-h-pulse-width = <8>;
		qcom,mdss-dsi-h-sync-skew = <0>;
		qcom,mdss-dsi-v-back-porch = <12>;
		qcom,mdss-dsi-v-front-porch = <5>;
		qcom,mdss-dsi-v-pulse-width = <2>;
		qcom,mdss-dsi-h-left-border = <0>;
		qcom,mdss-dsi-h-right-border = <0>;
		qcom,mdss-dsi-v-top-border = <0>;
		qcom,mdss-dsi-v-bottom-border = <0>;
		qcom,mdss-dsi-bpp = <24>;
		qcom,mdss-dsi-color-order = "rgb_swap_rgb";
		qcom,mdss-dsi-underflow-color = <0xff>;
		qcom,mdss-dsi-border-color = <0>;
		qcom,mdss-dsi-on-command = [
			39 01 00 00 00 00 04 BF 91 61 F2
			39 01 00 00 00 00 05 B3 00 AF 00 AF
			39 01 00 00 00 00 07 B8 00 BF 01 00 BF 01
			39 01 00 00 00 00 04 BA 3E 23 00
			39 01 00 00 00 00 02 C3 02
			39 01 00 00 00 00 03 C4 00 64
			39 01 00 00 00 00 0A C7 00 01 32 05 65 2B 12 A5 A5
			39 01 00 00 00 00 27 C8 7E 6C 52 3F 35 23 27 12 2E 31 35 59 4E 60 5A 62 5D 57 4E 7E 6C 52 3F 35 23 27 12 2E 31 35 59 4E 60 5A 62 5D 57 4E
			39 01 00 00 00 00 11 D4 1E 1F 17 37 06 04 0A 08 00 02 1F 1F 1F 1F 1F 1F
			39 01 00 00 00 00 11 D5 1E 1F 17 37 07 05 0B 09 01 03 1F 1F 1F 1F 1F 1F
			39 01 00 00 00 00 11 D6 1F 1E 17 17 07 09 0B 05 03 01 1F 1F 1F 1F 1F 1F
			39 01 00 00 00 00 11 D7 1F 1E 17 17 06 08 0A 04 02 00 1F 1F 1F 1F 1F 1F
			39 01 00 00 00 00 15 D8 20 00 00 30 03 30 01 02 00 01 02 06 70 00 00 73 07 06 70 08
			39 01 00 00 00 00 14 D9 00 0A 0A 80 00 00 06 7b 00 80 00 33 6A 1F 00 00 00 03 7b
			39 01 00 00 00 00 02 35 00
			39 01 00 00 00 00 02 BE 01
			39 01 00 00 00 00 0B CC 34 20 38 60 11 91 00 40 00 00
			39 01 00 00 00 00 02 BE 00
			39 01 00 00 00 00 02 51 00  //50% duty
			39 01 00 00 00 00 02 53 2C
			05 01 00 00 78 00 02 11 00
			05 01 00 00 0a 00 02 29 00
		];
		qcom,mdss-dsi-off-command = [
			/*tzb close backlight quickly when sleep in, 20170223*/
			39 01 00 00 78 00 02 53 00
			05 01 00 00 00 00 02 28 00
			05 01 00 00 28 00 02 10 00
			];
		qcom,mdss-dsi-on-command-state = "dsi_lp_mode";
		qcom,mdss-dsi-off-command-state = "dsi_hs_mode";
		qcom,mdss-dsi-h-sync-pulse = <1>;
		qcom,mdss-dsi-traffic-mode = "burst_mode";
		qcom,mdss-dsi-lane-map = "lane_map_0123";
		qcom,mdss-dsi-bllp-eof-power-mode;
		qcom,mdss-dsi-bllp-power-mode;
		qcom,suspend-ulps-enabled;
		qcom,mdss-dsi-lane-0-state;
		qcom,mdss-dsi-lane-1-state;
		qcom,mdss-dsi-panel-timings = [5D 12 0C 00 32 36 10 16 0F 03 04 00];
		qcom,mdss-dsi-t-clk-post = <0x05>;
		qcom,mdss-dsi-t-clk-pre = <0x15>;
		qcom,mdss-dsi-bl-min-level = <1>;
		qcom,mdss-dsi-bl-max-level = <255>;
		qcom,mdss-dsi-dma-trigger = "trigger_sw";
		qcom,mdss-dsi-mdp-trigger = "none";
		qcom,mdss-dsi-bl-pmic-control-type = "bl_ctrl_dcs";
		qcom,mdss-dsi-reset-sequence = <1 20>, <0 5>, <1 20>;
		qcom,mdss-dsi-lp11-init;
		qcom,mdss-dsi-init-delay-us = <7000>;
	};
};
