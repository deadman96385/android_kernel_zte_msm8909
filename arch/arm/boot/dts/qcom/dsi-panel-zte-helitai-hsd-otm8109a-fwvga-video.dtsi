/* Copyright (c) 2015, The Linux Foundation. All rights reserved.
 *
 * This program is free software; you can redistribute it and/or modify
 * it under the terms of the GNU General Public License version 2 and
 * only version 2 as published by the Free Software Foundation.
 *
 * This program is distributed in the hope that it will be useful,
 * but WITHOUT ANY WARRANTY; without even the implied warranty of
 * MERCHANTABILITY or FITNESS FOR A PARTICULAR PURPOSE.  See the
 * GNU General Public License for more details.
 */

&mdss_mdp {
	dsi_helitai_otm8019a_fwvga_video: qcom,zte-helitai-otm8019a-fwvga-video {
		qcom,mdss-dsi-panel-name = "zteHELITAI(OTM8019A)HSD_480*854_5.0Inch";
		qcom,mdss-dsi-panel-controller = <&mdss_dsi0>;
		qcom,mdss-dsi-panel-type = "dsi_video_mode";
		qcom,mdss-dsi-panel-destination = "display_1";
		qcom,cont-splash-enabled;
		qcom,mdss-dsi-panel-framerate = <60>;
		qcom,mdss-dsi-virtual-channel-id = <0>;
		qcom,mdss-dsi-stream = <0>;
		qcom,mdss-pan-physical-height-dimension = <110>;
		qcom,mdss-pan-physical-width-dimension = <62>;
		qcom,mdss-dsi-panel-width = <480>;
		qcom,mdss-dsi-panel-height = <854>;
		qcom,mdss-dsi-h-front-porch = <56>;
		qcom,mdss-dsi-h-back-porch = <10>;
		qcom,mdss-dsi-h-pulse-width = <4>;
		qcom,mdss-dsi-h-sync-skew = <0>;
		qcom,mdss-dsi-v-back-porch = <16>;
		qcom,mdss-dsi-v-front-porch = <4>;
		qcom,mdss-dsi-v-pulse-width = <4>;
		qcom,mdss-dsi-h-left-border = <0>;
		qcom,mdss-dsi-h-right-border = <0>;
		qcom,mdss-dsi-v-top-border = <0>;
		qcom,mdss-dsi-v-bottom-border = <0>;
		qcom,mdss-dsi-bpp = <24>;
		qcom,mdss-dsi-color-order = "rgb_swap_rgb";
		qcom,mdss-dsi-underflow-color = <0xff>;
		qcom,mdss-dsi-border-color = <0>;
		qcom,mdss-dsi-on-command = [
				39 01 00 00 00 00 02 00 00
				39 01 00 00 00 00 04 FF 80 19 01
				39 01 00 00 00 00 02 00 80
				39 01 00 00 00 00 03 FF 80 19
				39 01 00 00 00 00 02 00 B4
				39 01 00 00 00 00 02 C0 77
				39 01 00 00 00 00 02 00 82
				39 01 00 00 00 00 02 C5 B0
				39 01 00 00 00 00 02 00 90
				39 01 00 00 00 00 03 C5 4E 76
				39 01 00 00 00 00 02 00 81
				39 01 00 00 00 00 02 C1 33
				39 01 00 00 00 00 02 00 81
				39 01 00 00 00 00 02 C4 84
				39 01 00 00 00 00 02 00 92
				39 01 00 00 00 00 02 C5 01
				39 01 00 00 00 00 02 00 B1
				39 01 00 00 00 00 02 C5 A9
				39 01 00 00 00 00 02 00 93
				39 01 00 00 00 00 02 C5 03
				39 01 00 00 00 00 02 00 92
				39 01 00 00 00 00 02 B3 45
				39 01 00 00 00 00 02 00 90
				39 01 00 00 00 00 02 B3 02
				39 01 00 00 00 00 02 00 80
				39 01 00 00 00 00 06 C0 00 58 00 14 16
				39 01 00 00 00 00 02 00 90
				39 01 00 00 00 00 07 C0 00 15 00 00 00 04
				39 01 00 00 00 00 02 00 A6
				39 01 00 00 00 00 04 C1 01 00 01
				39 01 00 00 00 00 02 00 80
				39 01 00 00 00 00 0D CE 8B 03 0A 8A 03 0A 89 03 0A 88 03 0A
				39 01 00 00 00 00 02 00 A0
				39 01 00 00 00 00 0F CE 38 07 83 54 8C 0A 00 38 06 83 55 8C 0A 00
				39 01 00 00 00 00 02 00 B0
				39 01 00 00 00 00 0F CE 38 05 83 56 8C 0A 00 38 04 83 57 8C 0A 00
				39 01 00 00 00 00 02 00 C0
				39 01 00 00 00 00 0F CE 38 03 83 58 8C 0A 00 38 02 83 59 8C 0A 00
				39 01 00 00 00 00 02 00 D0
				39 01 00 00 00 00 0F CE 38 01 83 5A 8C 0A 00 38 00 83 5B 8C 0A 00
				39 01 00 00 00 00 02 00 C0
				39 01 00 00 00 00 0B CF 3D 3D 20 20 00 00 01 80 10 0A
				39 01 00 00 00 00 02 00 C0
				39 01 00 00 00 00 10 CB 15 15 15 15 15 15 15 15 15 15 00 00 00 00 00
				39 01 00 00 00 00 02 00 D0
				39 01 00 00 00 00 10 CB 00 00 00 00 00 00 00 00 00 00 00 15 15 15 15
				39 01 00 00 00 00 02 00 E0
				39 01 00 00 00 00 0B CB 15 15 15 15 15 15 00 00 00 00
				39 01 00 00 00 00 02 00 80
				39 01 00 00 00 00 0B CC 26 25 21 22 0C 0A 10 0E 02 04
				39 01 00 00 00 00 02 00 A0
				39 01 00 00 00 00 10 CC 00 03 01 0D 0F 09 0B 22 21 25 26 00 00 00 00
				39 01 00 00 00 00 02 00 B0
				39 01 00 00 00 00 0B CC 25 26 21 22 0B 0D 0F 09 03 01
				39 01 00 00 00 00 02 00 D0
				39 01 00 00 00 00 10 CC 00 02 04 0A 10 0E 0C 22 21 26 25 00 00 00 00
				39 01 00 00 00 00 02 00 00
				39 01 00 00 00 00 03 D8 6F 6F
				39 01 00 00 00 00 02 00 00
				39 01 00 00 00 00 15 E1 00 04 10 22 39 4F 59 8A 78 8E 79 69 82 6F 75 6E 67 5F 56 04
				39 01 00 00 00 00 02 00 00
				39 01 00 00 00 00 15 E2 00 04 10 22 39 4F 59 8A 78 8E 79 69 82 6F 75 6E 67 5F 56 04
				39 01 00 00 00 00 02 00 80
				39 01 00 00 00 00 02 C4 30
				39 01 00 00 00 00 02 00 98
				39 01 00 00 00 00 02 C0 00
				39 01 00 00 00 00 02 00 A9
				39 01 00 00 00 00 02 C0 0A
				39 01 00 00 00 00 02 00 B0
				39 01 00 00 00 00 04 C1 20 00 00
				39 01 00 00 00 00 02 00 E1
				39 01 00 00 00 00 03 C0 40 30
				39 01 00 00 00 00 02 00 80
				39 01 00 00 00 00 03 C1 03 33
				39 01 00 00 00 00 02 00 A0
				39 01 00 00 00 00 02 C1 E8
				39 01 00 00 00 00 02 00 90
				39 01 00 00 0a 00 02 B6 B4
				39 01 00 00 00 00 02 00 00
				39 01 00 00 00 00 02 FB 01
				39 01 00 00 00 00 02 00 00
				39 01 00 00 00 00 04 FF FF FF FF
				39 01 00 00 00 00 02 51 00
				39 01 00 00 00 00 02 53 2c
				39 01 00 00 00 00 02 35 00
				05 01 00 00 96 00 02 11 00
				05 01 00 00 14 00 02 29 00
			];
		qcom,mdss-dsi-off-command = [
				39 01 00 00 05 00 02 53 00
				05 01 00 00 00 00 02 28 00
				05 01 00 00 28 00 02 10 00];
		qcom,mdss-dsi-on-command-state = "dsi_lp_mode";
		qcom,mdss-dsi-off-command-state = "dsi_hs_mode";
		qcom,mdss-dsi-h-sync-pulse = <1>;
		qcom,mdss-dsi-traffic-mode = "burst_mode";
		qcom,mdss-dsi-lane-map = "lane_map_0123";
		qcom,mdss-dsi-bllp-eof-power-mode;
		qcom,mdss-dsi-bllp-power-mode;
		qcom,suspend-ulps-enabled;
		qcom,mdss-dsi-lane-0-state;
		qcom,mdss-dsi-lane-1-state;
		qcom,mdss-dsi-panel-timings = [52 16 0e 00 38 3A 12 18 10 03 04 00];
		qcom,mdss-dsi-t-clk-post = <0x04>;
		qcom,mdss-dsi-t-clk-pre = <0x14>;
		qcom,mdss-dsi-bl-min-level = <1>;
		qcom,mdss-dsi-bl-max-level = <255>;
		qcom,mdss-dsi-dma-trigger = "trigger_sw";
		qcom,mdss-dsi-mdp-trigger = "none";
		qcom,mdss-dsi-bl-pmic-control-type = "bl_ctrl_dcs";
		qcom,mdss-dsi-reset-sequence = <1 5>, <0 5>, <1 20>;
		qcom,mdss-dsi-lp11-init;
		qcom,mdss-dsi-init-delay-us = <7000>;
	};
};
