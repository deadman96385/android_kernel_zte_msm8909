/* Copyright (c) 2015, The Linux Foundation. All rights reserved.
 *
 * This program is free software; you can redistribute it and/or modify
 * it under the terms of the GNU General Public License version 2 and
 * only version 2 as published by the Free Software Foundation.
 *
 * This program is distributed in the hope that it will be useful,
 * but WITHOUT ANY WARRANTY; without even the implied warranty of
 * MERCHANTABILITY or FITNESS FOR A PARTICULAR PURPOSE.  See the
 * GNU General Public License for more details.
 */

&mdss_mdp {
	dsi_txd_jd9161b_fwvga_video: qcom,mdss_dsi_txd_jd9161b_hsd_5p_fwvga_video {
		qcom,mdss-dsi-panel-name = "zteTONGXINGDA_JD9161B_HSD_480_854_5.0Inch";
		qcom,mdss-dsi-panel-controller = <&mdss_dsi0>;
		qcom,mdss-dsi-panel-type = "dsi_video_mode";
		qcom,mdss-dsi-panel-destination = "display_1";
		qcom,mdss-dsi-panel-framerate = <60>;
		qcom,mdss-dsi-virtual-channel-id = <0>;
		qcom,mdss-dsi-stream = <0>;
		qcom,cont-splash-enabled;
		qcom,mdss-pan-physical-height-dimension = <110>;
		qcom,mdss-pan-physical-width-dimension = <62>;
		qcom,mdss-dsi-panel-width = <480>;
		qcom,mdss-dsi-panel-height = <854>;
		qcom,mdss-dsi-h-front-porch = <24>;
		qcom,mdss-dsi-h-back-porch = <24>;
		qcom,mdss-dsi-h-pulse-width = <8>;
		qcom,mdss-dsi-h-sync-skew = <0>;
		qcom,mdss-dsi-v-back-porch = <15>;
		qcom,mdss-dsi-v-front-porch = <17>;
		qcom,mdss-dsi-v-pulse-width = <2>;
		qcom,mdss-dsi-h-left-border = <0>;
		qcom,mdss-dsi-h-right-border = <0>;
		qcom,mdss-dsi-v-top-border = <0>;
		qcom,mdss-dsi-v-bottom-border = <0>;
		qcom,mdss-dsi-bpp = <24>;
		qcom,mdss-dsi-color-order = "rgb_swap_rgb";
		qcom,mdss-dsi-underflow-color = <0xff>;
		qcom,mdss-dsi-border-color = <0>;
		zte,lcd-backlight-min-value-limit;
		qcom,mdss-dsi-on-command = [
			39 01 00 00 00 00 04 BF 91 61 F2
			39 01 00 00 00 00 03 B3 00 7E
			39 01 00 00 00 00 03 B4 00 8E
			39 01 00 00 00 00 07 B8 00 BF 01 00 BF 01
			39 01 00 00 00 00 04 BA 3E 23 00
			39 01 00 00 00 00 02 C3 02
			39 01 00 00 00 00 03 C4 30 6A
			39 01 00 00 00 00 0A C7 00 21 42 05 25 2B 12 A5 A5
			39 01 00 00 00 00 27 c8 7E 72 58 3F 2E 1B 1D 08 25 28 2D 52 48 5B 55 5E 5A 55 4E 7E
			72 58 3F 2E 1B 1D 08 25 28 2D 52 48 5B 55 5E 5A 55 4E
			39 01 00 00 00 00 11 D4 1E 1F 17 37 06 04 0A 08 00 02 1F 1F 1F 1F 1F 1F
			39 01 00 00 00 00 11 D5 1E 1F 17 37 07 05 0B 09 01 03 1F 1F 1F 1F 1F 1F
			39 01 00 00 00 00 11 D6 1F 1E 17 17 07 09 0B 05 03 01 1F 1F 1F 1F 1F 1F
			39 01 00 00 00 00 11 D7 1F 1E 17 17 06 08 0A 04 02 00 1F 1F 1F 1F 1F 1F
			39 01 00 00 00 00 15 D8 20 00 00 30 06 30 01 02 00 01 02 70 6c 00 00 73 0A 70 6C 08
			39 01 00 00 00 00 14 D9 00 0F 00 80 00 00 06 7b 00 bc 00 3b 6d 18 00 00 00 03 7B
			39 01 00 00 00 00 02 35 00
			39 01 00 00 00 00 02 BE 01
			39 01 00 00 00 00 02 C1 10
			39 01 00 00 00 00 0B cc 34 20 38 60 11 91 00 40 00 00
			39 01 00 00 00 00 02 C5 04
			39 01 00 00 00 00 02 BE 00
			39 01 00 00 00 00 05 D0 2E 00 01 03
			39 01 00 00 00 00 02 51 00
			39 01 00 00 00 00 02 53 2c
			05 01 00 00 78 00 02 11 00
			05 01 00 00 14 00 02 29 00
		];
		qcom,mdss-dsi-off-command = [
			39 01 00 00 78 00 02 53 00
			05 01 00 00 00 00 02 28 00
			05 01 00 00 28 00 02 10 00
		];

		qcom,mdss-dsi-on-command-state = "dsi_lp_mode";
		qcom,mdss-dsi-off-command-state = "dsi_hs_mode";
		qcom,mdss-dsi-h-sync-pulse = <1>;
		qcom,mdss-dsi-traffic-mode = "burst_mode";
		qcom,mdss-dsi-lane-map = "lane_map_0123";
		qcom,mdss-dsi-bllp-eof-power-mode;
		qcom,mdss-dsi-bllp-power-mode;
		qcom,suspend-ulps-enabled;
		qcom,mdss-dsi-lane-0-state;
		qcom,mdss-dsi-lane-1-state;
		qcom,mdss-dsi-panel-timings = [6B 16 0c 00 38 3A 12 18 11 03 04 00];
		qcom,mdss-dsi-t-clk-post = <0x04>;
		qcom,mdss-dsi-t-clk-pre = <0x17>;
		qcom,mdss-dsi-bl-min-level = <1>;
		qcom,mdss-dsi-bl-max-level = <255>;
		qcom,mdss-dsi-dma-trigger = "trigger_sw";
		qcom,mdss-dsi-mdp-trigger = "none";
		qcom,mdss-dsi-bl-pmic-control-type = "bl_ctrl_dcs";
		qcom,mdss-dsi-reset-sequence = <1 20>, <0 10>, <1 20>;
		qcom,mdss-dsi-lp11-init;
		qcom,mdss-dsi-init-delay-us = <7000>;
		qcom,mdss-dsi-panel-status-command = [04 01 00 01 05 00 01 0A];
		qcom,mdss-dsi-panel-status-command-second  = [14 01 00 01 05 00 01 09];
		qcom,mdss-dsi-panel-status-value-second = <0x80>;
		qcom,mdss-dsi-panel-status-command-mode = "dsi_hs_mode";
		qcom,mdss-dsi-panel-status-check-mode = "reg_read_jd9161";
		qcom,mdss-dsi-panel-status-read-length = <1>;
		qcom,mdss-dsi-panel-status-value = <0x9C>;
		qcom,esd-check-enabled;
		qcom,esd-check-enabled-second;
	};
};
