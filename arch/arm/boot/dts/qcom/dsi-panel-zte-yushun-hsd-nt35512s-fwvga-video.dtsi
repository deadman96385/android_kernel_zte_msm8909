/* Copyright (c) 2015, The Linux Foundation. All rights reserved.
 *
 * This program is free software; you can redistribute it and/or modify
 * it under the terms of the GNU General Public License version 2 and
 * only version 2 as published by the Free Software Foundation.
 *
 * This program is distributed in the hope that it will be useful,
 * but WITHOUT ANY WARRANTY; without even the implied warranty of
 * MERCHANTABILITY or FITNESS FOR A PARTICULAR PURPOSE.  See the
 * GNU General Public License for more details.
 */

&mdss_mdp {
	dsi_nt35512s_fwvga_video: qcom,mdss_dsi_nt35512s_fwvga_video {
		qcom,mdss-dsi-panel-name = "zteYUSHUN(nt35512s)hsd_480*854_5.0Inch";
		qcom,mdss-dsi-panel-controller = <&mdss_dsi0>;
		qcom,mdss-dsi-panel-type = "dsi_video_mode";
		qcom,mdss-dsi-panel-destination = "display_1";
		qcom,cont-splash-enabled;
		qcom,mdss-dsi-panel-framerate = <60>;
		qcom,mdss-dsi-virtual-channel-id = <0>;
		qcom,mdss-dsi-stream = <0>;
		qcom,mdss-pan-physical-height-dimension = <110>;
		qcom,mdss-pan-physical-width-dimension = <62>;
		qcom,mdss-dsi-panel-width = <480>;
		qcom,mdss-dsi-panel-height = <854>;
		qcom,mdss-dsi-h-front-porch = <80>;
		qcom,mdss-dsi-h-back-porch = <80>;
		qcom,mdss-dsi-h-pulse-width = <40>;
		qcom,mdss-dsi-h-sync-skew = <0>;
		qcom,mdss-dsi-v-back-porch = <13>;
		qcom,mdss-dsi-v-front-porch = <11>;
		qcom,mdss-dsi-v-pulse-width = <2>;
		qcom,mdss-dsi-h-left-border = <0>;
		qcom,mdss-dsi-h-right-border = <0>;
		qcom,mdss-dsi-v-top-border = <0>;
		qcom,mdss-dsi-v-bottom-border = <0>;
		qcom,mdss-dsi-bpp = <24>;
		qcom,mdss-dsi-color-order = "rgb_swap_rgb";
		qcom,mdss-dsi-underflow-color = <0xff>;
		qcom,mdss-dsi-border-color = <0>;
		qcom,mdss-dsi-on-command = [
			39 00 00 00 00 00 05 FF AA 55 69 10
			39 00 00 00 00 00 02 6F 10
			39 00 00 00 00 00 02 B7 01
			39 00 00 00 00 00 02 6F 02
			39 00 00 00 00 00 02 F2 28
			39 00 00 00 00 00 02 6F 0c
			39 00 00 00 00 00 02 FE 18
			39 00 00 00 00 00 05 FF AA 55 69 00
			39 00 00 00 00 00 06 F0 55 AA 52 08 02 //#LV2 Page 2 enable
			39 00 00 00 00 00 02 B7 01 //Gamma select
			39 00 00 00 00 00 02 B4 64    //30.7KHz
			39 00 00 00 00 00 06 F0 55 AA 52 08 01 //#LV2 Page 1 enable
			39 00 00 00 00 00 02 B0 0D //#AVDD Set AVDD 5.2V
			39 00 00 00 00 00 02 B6 44 //#AVDD ratio
			39 00 00 00 00 00 02 B1 0D //#AVEE  -5.2V
			39 00 00 00 00 00 02 B7 34 //#AVEE ratio
			39 00 00 00 00 00 02 B2 00 //#VCL  -2.5V
			39 00 00 00 00 00 02 B8 24 //#VCL ratio
			39 00 00 00 00 00 02 BF 01 //#VGH 15V
			39 00 00 00 00 00 02 B3 0f //0f
			39 00 00 00 00 00 02 B9 34 //#VGH ratio
			39 00 00 00 00 00 02 B5 08 //#VGL_REG -10V
			39 00 00 00 00 00 02 C2 03
			39 00 00 00 00 00 04 BA 34 34 34 //#VGLX ratio
			39 00 00 00 00 00 04 BC 00 78 00 //#VGMP/VGSP 4.5V/0V
			39 00 00 00 00 00 04 BD 00 78 00 //#VGMN/VGSN -4.5V/0V
			39 00 00 00 00 00 05 BE 00 59 00 59 //#VCOM  -1.5V
			39 00 00 00 00 00 35 D1 00 3D 00 3E 00 44 00 52 00 78 00 A3 00 CD 01 09 01 37 01 72 01 A0 01 E3 02 15 02 16 02 41 02 6B 02 83 02 9E 02 AE 02 C5 02 D4 02 E9 02 FA 03 15 03 3C 03 8E //#Gamma Setting
			39 00 00 00 00 00 06 F0 55 AA 52 08 00 //#LV2 Page 0 enable
			39 00 00 00 00 00 02 B2 00
			39 00 00 00 00 00 02 B5 6B //#48854
			39 00 00 00 00 00 03 B1 FC 00 //#Display control
			39 00 00 00 00 00 02 B6 03 //#Source hold time
			39 00 00 00 00 00 03 B7 70 70 //#Gate EQ control
			39 00 00 00 00 00 05 B8 01 03 03 03 //#Source EQ control (Mode 2)
			39 00 00 00 00 00 02 BC 02 //#Inversion mode  (2-dot)
			39 00 00 00 00 00 06 C9 C0 02 50 50 50 //#Timing control 4H w/ 4-delay
			39 00 00 00 00 00 03 E0 01 01
			39 00 00 00 00 00 02 53 24
			05 01 00 00 78 00 02 11 00
			05 01 00 00 10 00 02 29 00];
		qcom,mdss-dsi-off-command = [
			05 01 00 00 00 00 02 28 00
			05 01 00 00 28 00 02 10 00
			15 01 00 00 00 00 02 4f 01];
		qcom,mdss-dsi-on-command-state = "dsi_lp_mode";
		qcom,mdss-dsi-off-command-state = "dsi_hs_mode";
		qcom,mdss-dsi-h-sync-pulse = <1>;
		qcom,mdss-dsi-traffic-mode = "burst_mode";
		qcom,mdss-dsi-lane-map = "lane_map_0123";
		qcom,mdss-dsi-bllp-eof-power-mode;
		qcom,mdss-dsi-bllp-power-mode;
		qcom,suspend-ulps-enabled;
		qcom,mdss-dsi-lane-0-state;
		qcom,mdss-dsi-lane-1-state;
		qcom,mdss-dsi-panel-timings = [7A 1A 12 00 3E 42 16 1E 14 03 04 00];
		qcom,mdss-dsi-t-clk-post = <0x04>;
		qcom,mdss-dsi-t-clk-pre = <0x26>;
		qcom,mdss-dsi-bl-min-level = <1>;
		qcom,mdss-dsi-bl-max-level = <255>;
		qcom,mdss-dsi-dma-trigger = "trigger_sw";
		qcom,mdss-dsi-mdp-trigger = "none";
		qcom,mdss-dsi-bl-pmic-control-type = "bl_ctrl_dcs";
		qcom,mdss-dsi-reset-sequence = <1 5>, <0 5>, <1 20>;
		qcom,mdss-dsi-lp11-init;
		qcom,mdss-dsi-init-delay-us = <7000>;
	};
};
